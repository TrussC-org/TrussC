#include "tcxLua.h"
#include "TrussC.h"

#include "sol/sol.hpp"
using namespace tc;

// WORKAROUND: to support deprecated functions in lua
#ifndef _MSC_VER
#pragma GCC diagnostic push
#pragma GCC diagnostic ignored "-Wdeprecated-declarations"
#pragma clang diagnostic push
#pragma clang diagnostic ignored "-Wdeprecated-declarations"
#endif // #ifndef _MSC_VER

// namespace tcx::lua {

namespace sol
{
    template <>
    struct is_automagical<std::filesystem::path> : std::false_type {};
}

bool tcxLua::canUseLuaJITFromSol2(){
    #ifdef TCXLUA_USE_LUAJIT
    return true;
    #else // TCXLUA_USE_LUAJIT
    return false;
    #endif // TCXLUA_USE_LUAJIT
}

std::shared_ptr<sol::state> tcxLua::getLuaState(tcxLua::LuaModulePreferences module_preference){
    std::shared_ptr<sol::state> lua = std::make_shared<sol::state>();

    #ifdef TCXLUA_USE_LUAJIT
    lua->open_libraries(sol::lib::jit);
    #endif // TCXLUA_USE_LUAJIT

    // lua->open_libraries(
    //     sol::lib::base,
    //     sol::lib::math,
    //     sol::lib::string,
    //     sol::lib::table,
    //     sol::lib::package,
    //     sol::lib::coroutine,
    //     sol::lib::io
    // );

    auto&& mp = module_preference;

    if(mp.base){
        lua->open_libraries(sol::lib::base);
    }
    if(mp.math){
        lua->open_libraries(sol::lib::math);
    }
    if(mp.string){
        lua->open_libraries(sol::lib::string);
    }
    if(mp.table){
        lua->open_libraries(sol::lib::table);
    }
    if(mp.package){
        lua->open_libraries(sol::lib::package);
    }
    if(mp.coroutine){
        lua->open_libraries(sol::lib::coroutine);
    }
    if(mp.io){
        lua->open_libraries(sol::lib::io);
    }
    if(mp.os){
        lua->open_libraries(sol::lib::os);
    }
    if(mp.debug){
        lua->open_libraries(sol::lib::debug);
    }
    if(mp.bit32){
        lua->open_libraries(sol::lib::bit32);
    }
    if(mp.ffi){
        lua->open_libraries(sol::lib::ffi);
    }
    if(mp.utf8){
        lua->open_libraries(sol::lib::utf8);
    }

    setBindings(lua);

    return lua;
}

std::string tcxLua::getLuaVersionEstimated(const std::shared_ptr<sol::state>& lua){
    std::string luaSource = R"LUA(
        function ___internal_estimated_lua_version()
            if ({false, [1] = true})[1] then   -- luacheck: ignore 314
                return 'LuaJIT'
            elseif 1 / 0 == 1 / '-0' then
                return 0 + '0' .. '' == '0' and 'Lua 5.4' or 'Lua 5.3'
            end
            local f = function() return function() end end
            return f() == f() and 'Lua 5.2' or 'Lua 5.1'
        end
    )LUA";
    
    lua->safe_script(luaSource);

    sol::protected_function_result result = ((*lua)["___internal_estimated_lua_version"])();

    if (result.get_type() == sol::type::string){
        return result.get<std::string>();
    }else{
        return "Unknown";
    }
}

bool tcxLua::isLuaJITUsedEstimated(const std::shared_ptr<sol::state>& lua){
    std::string luaVersionStr = getLuaVersionEstimated(lua);
    return luaVersionStr == "LuaJIT";
}

void tcxLua::setBindings(const std::shared_ptr<sol::state>& lua){
    setTrussCGeneratedBindings(lua);
    setGeneratedTypeBindings(lua);   // luagen-types: 83 generated usertypes (Phase 2)
    setTypeBindings(lua);
    setConstBindings(lua);
    setColorConstBindings(lua);
    setMathBindings(lua);

    // getElapsedTimef/getDataPath are free functions -> generated by luagen.
    // toPath/fromPath/pathToString are hand-only (luagen doesn't emit them).
    lua->set_function("toPath", [](const std::string& s){
        std::filesystem::path p(s);
        return s;
    });
    lua->set_function("fromPath", [](const std::filesystem::path& p){
        return p.string();
    });
    lua->set_function("pathToString", [](const std::filesystem::path& p){
        return p.string();
    });
}

void tcxLua::setConstBindings(const std::shared_ptr<sol::state>& lua){
    // Constants (TAU/PI/KEY_*/...) are now GENERATED by luagen-types from
    // reference-data (kind:var, non-hidden) into trussctype_generated.cpp.
    (void)lua;
}

template<typename T>
inline void json_new_index_table_fn(Json& j, T i, const sol::table& tbl){
    int _i = 0;
    for (std::pair<sol::object, sol::object>& kv : tbl) 
    {
        if (kv.first.get_type() == sol::type::string)
        {
            std::string key = kv.first.as<std::string>();
            // std::cerr << key << std::endl;
            // std::cerr << key << ": " << kv.second() << std::endl;

            if(kv.second.get_type() == sol::type::number){
                lua_Number v = kv.second.as<lua_Number>();
                j[i][key] = v;
            }else if(kv.second.get_type() == sol::type::string){
                std::string v = kv.second.as<std::string>();
                j[i][key] = v;
            }else if(kv.second.get_type() == sol::type::nil){
                nlohmann::json j_null;
                j[i][key] = j_null;
            }else if(kv.second.get_type() == sol::type::none){
                nlohmann::json j_null;
                j[i][key] = j_null;
            }else if(kv.second.get_type() == sol::type::table){
                j[i][key] = nlohmann::json::object({});
                auto&& v = kv.second.as<sol::table>();
                json_new_index_table_fn(j[i], key, v);
            }else{
                std::cerr << "[tcxLua error] unsupported table insertion";
                std::cerr << " (debug value type id: " << (int)kv.second.get_type() << ")" << std::endl;
                assert(false);
            }
        }

        if (kv.first.get_type() == sol::type::number)
        {
            lua_Number _key = kv.first.as<lua_Number>();
            int key = _key - 1; // Lua index workaround

            // std::cerr << key << std::endl;
            // std::cerr << key << ": " << kv.second() << std::endl;

            if(kv.second.get_type() == sol::type::number){
                lua_Number v = kv.second.as<lua_Number>();
                j[i][key] = v;
            }else if(kv.second.get_type() == sol::type::string){
                std::string v = kv.second.as<std::string>();
                j[i][key] = v;
            }else if(kv.second.get_type() == sol::type::nil){
                nlohmann::json j_null;
                j[i][key] = j_null;
            }else if(kv.second.get_type() == sol::type::none){
                nlohmann::json j_null;
                j[i][key] = j_null;
            }else if(kv.second.get_type() == sol::type::table){
                j[i][key] = nlohmann::json::object({});
                auto&& v = kv.second.as<sol::table>();
                json_new_index_table_fn(j[i], key, v);
            }else{
                std::cerr << "[tcxLua error] unsupported table insertion";
                std::cerr << " (debug value type id: " << (int)kv.second.get_type() << ")" << std::endl;
                assert(false);
            }
        }

        _i++;
    }

    if(_i == 0){
        j[i] = nlohmann::json::object({});
    }
}

void tcxLua::setTypeBindings(const std::shared_ptr<sol::state>& lua){






    sol::usertype<Mat4> mat4_type = lua->new_usertype<Mat4>("Mat4",
        sol::constructors<Mat4(),
            Mat4(float m00, float m01, float m02, float m03,
                 float m10, float m11, float m12, float m13,
                 float m20, float m21, float m22, float m23,
                 float m30, float m31, float m32, float m33),
            Mat4(const Mat4&)>(),
        sol::call_constructor, sol::constructors<Mat4(),
            Mat4(float m00, float m01, float m02, float m03,
                 float m10, float m11, float m12, float m13,
                 float m20, float m21, float m22, float m23,
                 float m30, float m31, float m32, float m33),
            Mat4(const Mat4&)>(),
        sol::meta_function::multiplication,
        sol::overload(
           [](const Mat4& a, const Mat4& b){ return a * b; },
           [](const Mat4& a, const Vec3& b){ return a * b; },
           [](const Mat4& a, const Vec4& b){ return a * b; }
        )
    );
    mat4_type["at"] = [](Mat4& m, int raw, int col) { return m.at(raw, col); };
    mat4_type["set"] = [](Mat4& m, int raw, int col, int v){ m.at(raw, col) = v; }; // WORKAROUND
    mat4_type["identity"] = &Mat4::identity;
    mat4_type["fromHomography"] = &Mat4::fromHomography;
    mat4_type["translate"] = sol::overload(
        [](Mat4& m, float tx, float ty, float tz){ return m.translate(tx, ty, tz); },
        [](Mat4& m, const Vec3& t){ return m.translate(t); }
    );
    mat4_type["rotateX"] = &Mat4::rotateX;
    mat4_type["rotateY"] = &Mat4::rotateY;
    mat4_type["rotateZ"] = &Mat4::rotateZ;
    mat4_type["rotate"] = &Mat4::rotate;
    mat4_type["scale"] = sol::overload(
        [](Mat4& m, float s){ return m.scale(s); },
        [](Mat4& m, float sx, float sy, float sz){ return m.scale(sx, sy, sz); },
        [](Mat4& m, const Vec3& s){ return m.scale(s); }
    );
    mat4_type["transposed"] = &Mat4::transposed;
    mat4_type["inverted"] = &Mat4::inverted;
    mat4_type["lookAt"] = &Mat4::lookAt;
    mat4_type["ortho"] = &Mat4::ortho;
    mat4_type["perspective"] = &Mat4::perspective;
    mat4_type["frustum"] = &Mat4::frustum;

    sol::usertype<Mat3> mat3_type = lua->new_usertype<Mat3>("Mat3",
        sol::constructors<Mat3(),
            Mat3(float m00, float m01, float m02,
                 float m10, float m11, float m12,
                 float m20, float m21, float m22),
            Mat3(const Mat3&)>(),
        sol::call_constructor, sol::constructors<Mat3(),
            Mat3(float m00, float m01, float m02,
                 float m10, float m11, float m12,
                 float m20, float m21, float m22),
            Mat3(const Mat3&)>(),
        sol::meta_function::multiplication,
        sol::overload(
           [](const Mat3& a, const Mat3& b){ return a * b; },
           [](const Mat3& a, const Vec2& b){ return a * b; },
           [](const Mat3& a, const Vec3& b){ return a * b; }
        )
    );
    mat3_type["at"] = [](Mat3& m, int raw, int col) { return m.at(raw, col); };
    mat3_type["set"] = [](Mat3& m, int raw, int col, int v){ m.at(raw, col) = v; }; // WORKAROUND
    mat3_type["identity"] = &Mat3::identity;
    mat3_type["getHomography"] = &Mat3::getHomography;
    mat3_type["determinant"] = &Mat3::determinant;
    mat3_type["translate"] = sol::overload(
        [](Mat3& m, float tx, float ty){ return m.translate(tx, ty); },
        [](Mat3& m, const Vec2& t){ return m.translate(t); }
    );
    mat3_type["rotate"] = &Mat3::rotate;
    mat3_type["scale"] = sol::overload(
        [](Mat3& m, float s){ return m.scale(s); },
        [](Mat3& m, float sx, float sy){ return m.scale(sx, sy); },
        [](Mat3& m, const Vec2& s){ return m.scale(s); }
    );
    mat3_type["transposed"] = &Mat3::transposed;
    mat3_type["inverted"] = &Mat3::inverted;

    // FIXME: this makes compilation error
    // using StdPath = std::filesystem::path;
    // lua->new_usertype<StdPath>("StdPath",
    //     sol::constructors<StdPath(), StdPath(const std::string&)>(),
    //     sol::meta_function::division,
    //     sol::overload(
    //         [](StdPath& a, const StdPath& b){ return a / b; },
    //         [](StdPath& a, const std::string& b){ return a / b; }
    //     ),
    //     "c_str", [](StdPath& p){ return p.c_str(); },
    //     "string", [](StdPath& p){ return p.string(); },
    //     "exists", [](StdPath& p){ return std::filesystem::exists(p); },
    //     "is_directory", [](StdPath& p){ return std::filesystem::is_directory(p); },
    //     "is_dir", [](StdPath& p){ return std::filesystem::is_directory(p); },
    //     "is_file", [](StdPath& p){ return std::filesystem::is_regular_file(p); },
    //     "is_regular_file", [](StdPath& p){ return std::filesystem::is_regular_file(p); },
    //     "is_empty", [](StdPath& p){ return std::filesystem::is_empty(p); },
    //     "absolute", [](StdPath& p){ return std::filesystem::absolute(p); },
    //     "relative", sol::overload(
    //         [](StdPath& p){ return std::filesystem::relative(p); },
    //         [](StdPath& p, const StdPath& b){ return std::filesystem::relative(p, b); }
    //     )
    // );
    


    sol::usertype<Fbo> fbo_type = lua->new_usertype<Fbo>("Fbo",
        sol::constructors<Fbo()>(),
        sol::call_constructor, sol::constructors<Fbo()>() // FIXME: move constructor?
    );

    fbo_type["allocate"] = sol::overload(
        [](Fbo& f, int w, int h){ return f.allocate(w, h); },
        [](Fbo& f, int w, int h, int sampleCount){ return f.allocate(w, h, sampleCount); },
        [](Fbo& f, int w, int h, int sampleCount, TextureFormat t){ return f.allocate(w, h, sampleCount, t); }
    );
    fbo_type["clear"] = &Fbo::clear;
    fbo_type["begin"] = sol::overload(
        [](Fbo& f){ return f.begin(); },
        [](Fbo& f, float r, float g, float b){ return f.begin(r, g, b); },
        [](Fbo& f, float r, float g, float b, float a){ return f.begin(r, g, b, a); }
    );
    fbo_type["clearColor"] = &Fbo::clearColor;
    fbo_type["end"] = &Fbo::end;
    fbo_type["end_fbo"] = &Fbo::end;
    fbo_type["readPixels"] = &Fbo::readPixels;
    fbo_type["readPixelsFloat"] = &Fbo::readPixelsFloat;
    fbo_type["copyTo"] = &Fbo::copyTo;
    fbo_type["getWidth"] = &Fbo::getWidth;
    fbo_type["getHeight"] = &Fbo::getHeight;
    fbo_type["getSampleCount"] = &Fbo::getSampleCount;
    fbo_type["getTextureFormat"] = &Fbo::getTextureFormat;
    fbo_type["isAllocated"] = &Fbo::isAllocated;
    fbo_type["isActive"] = &Fbo::isActive;
    fbo_type["getTexture"] = [](Fbo& f) -> Texture& { return f.getTexture(); };
    fbo_type["save"] = sol::overload(
        &Fbo::save,
        [](Fbo& t, const std::string& s){ return t.save(s); }
    );
    fbo_type["draw"] = sol::overload(
        [](Fbo& t, float x, float y){ return t.draw(x, y); },
        [](Fbo& t, float x, float y, float w, float h){ return t.draw(x, y, w, h); }
    );
    fbo_type["getColorImage"] = &Fbo::getColorImage;
    fbo_type["getTextureView"] = &Fbo::getTextureView;
    fbo_type["getSampler"] = &Fbo::getSampler;

    sol::usertype<Texture> tex_type = lua->new_usertype<Texture>("Texture",
        sol::constructors<Texture()>(),
        sol::call_constructor, sol::constructors<Texture()>() // FIXME: move constructor?
    );
    tex_type["allocate"] = sol::overload(
        [](Texture& f, int w, int h){ return f.allocate(w, h); },
        [](Texture& f, int w, int h, int c){ return f.allocate(w, h, c); },
        [](Texture& f, int w, int h, int c, TextureUsage t){ return f.allocate(w, h, c, t); },
        [](Texture& f, int w, int h, int c, TextureUsage t, int s){ return f.allocate(w, h, c, t, s); },
        [](Texture& f, int w, int h, TextureFormat c){ return f.allocate(w, h, c); },
        [](Texture& f, int w, int h, TextureFormat c, TextureUsage t){ return f.allocate(w, h, c, t); },
        [](Texture& f, int w, int h, TextureFormat c, TextureUsage t, int s){ return f.allocate(w, h, c, t, s); },
        [](Texture& f, const Pixels& w){ return f.allocate(w); },
        [](Texture& f, const Pixels& w, TextureUsage c){ return f.allocate(w, c); },
        [](Texture& f, const Pixels& w, TextureUsage c, bool m){ return f.allocate(w, c, m); }
    );
    tex_type["allocateCubemap"] = sol::overload(
        [](Texture& f, int w, TextureFormat c){ return f.allocateCubemap(w, c); },
        [](Texture& f, int w, TextureFormat c, TextureUsage t){ return f.allocateCubemap(w, c, t); },
        [](Texture& f, int w, TextureFormat c, TextureUsage t, int s){ return f.allocateCubemap(w, c, t, s); }
    );
    tex_type["uploadCubemapFace"] = &Texture::uploadCubemapFace;
    tex_type["uploadCubemapMip"] = &Texture::uploadCubemapMip;
    tex_type["getCubemapFaceAttachmentView"] = &Texture::getCubemapFaceAttachmentView;
    tex_type["isCubemap"] = &Texture::isCubemap;
    tex_type["getNumMipLevels"] = &Texture::getNumMipLevels;
    tex_type["allocateCompressed"] = &Texture::allocateCompressed;
    tex_type["updateCompressed"] = &Texture::updateCompressed;
    tex_type["isCompressed"] = &Texture::isCompressed;
    tex_type["clear"] = &Texture::clear;
    tex_type["isAllocated"] = &Texture::isAllocated;
    tex_type["getWidth"] = &Texture::getWidth;
    tex_type["getHeight"] = &Texture::getHeight;
    tex_type["getChannels"] = &Texture::getChannels;
    tex_type["getUsage"] = &Texture::getUsage;
    tex_type["getSampleCount"] = &Texture::getSampleCount;
    tex_type["getPixelFormat"] = &Texture::getPixelFormat;
    tex_type["loadData"] = sol::overload(
        [](Texture& t, const Pixels& p){ return t.loadData(p); },
        [](Texture& t, const unsigned char* d, int w, int h, int c){ return t.loadData(d, w, h, c); },
        [](Texture& t, const void* d, int w, int h, int c){ return t.loadData(d, w, h, c); }
    );
    tex_type["setMinFilter"] = &Texture::setMinFilter;
    tex_type["setMagFilter"] = &Texture::setMagFilter;
    tex_type["setFilter"] = &Texture::setFilter;
    tex_type["getMinFilter"] = &Texture::getMinFilter;
    tex_type["getMagFilter"] = &Texture::getMagFilter;
    tex_type["setPremultipliedAlpha"] = &Texture::setPremultipliedAlpha;
    tex_type["isPremultipliedAlpha"] = &Texture::isPremultipliedAlpha;
    tex_type["setWrapU"] = &Texture::setWrapU;
    tex_type["setWrapV"] = &Texture::setWrapV;
    tex_type["setWrap"] = &Texture::setWrap;
    tex_type["getWrapU"] = &Texture::getWrapU;
    tex_type["getWrapV"] = &Texture::getWrapV;
    tex_type["draw"] = sol::overload(
        [](Texture& t, float x, float y){ return t.draw(x, y); },
        [](Texture& t, float x, float y, float w, float h){ return t.draw(x, y, w, h); }
    );
    tex_type["drawSubsection"] = &Texture::drawSubsection;
    tex_type["bind"] = &Texture::bind;
    tex_type["unbind"] = &Texture::unbind;
    tex_type["getImage"] = &Texture::getImage;
    tex_type["getView"] = &Texture::getView;
    tex_type["getSampler"] = &Texture::getSampler;
    tex_type["getAttachmentView"] = &Texture::getAttachmentView;


    sol::usertype<Image> img_type = lua->new_usertype<Image>("Image",
        sol::constructors<Image()>(),
        sol::call_constructor, sol::constructors<Image()>() // FIXME: move constructor?
    );
    img_type["load"] = sol::overload(
        &Image::load,
        [](Image& t, const std::string& s){ return t.load(s); }
    );
    img_type["save"] = sol::overload(
        &Image::save,
        [](Image& t, const std::string& s){ return t.save(s); }
    );
    img_type["loadFromMemory"] = &Image::loadFromMemory;
    img_type["allocate"] = sol::overload(
        [](Image& t, int w, int h){ return t.allocate(w, h); },
        [](Image& t, int w, int h, int c){ return t.allocate(w, h, c); }
    );
    img_type["clear"] = &Image::clear;
    img_type["draw"] = sol::overload(
        [](Image& t, float x, float y){ return t.draw(x, y); },
        [](Image& t, float x, float y, float w, float h){ return t.draw(x, y, w, h); }
    );
    img_type["isAllocated"] = &Image::isAllocated;
    img_type["getWidth"] = &Image::getWidth;
    img_type["getHeight"] = &Image::getHeight;
    img_type["getChannels"] = &Image::getChannels;
    img_type["getPixels"] = [](Image& f) -> Pixels& { return f.getPixels(); };
    img_type["getPixelsData"] = [](Image& f) -> unsigned char* { return f.getPixelsData(); };
    img_type["getColor"] = &Image::getColor;
    img_type["setColor"] = &Image::setColor;
    img_type["update"] = &Image::update;
    img_type["setDirty"] = &Image::setDirty;
    img_type["getTexture"] = [](Image& f) -> Texture& { return f.getTexture(); };

    sol::usertype<Pixels> pix_type = lua->new_usertype<Pixels>("Pixels",
        sol::constructors<Pixels()>(),
        sol::call_constructor, sol::constructors<Pixels()>() // FIXME: move constructor?
    );
    pix_type["allocate"] = sol::overload(
        [](Pixels& f, int w, int h){ return f.allocate(w, h); },
        [](Pixels& f, int w, int h, int c){ return f.allocate(w, h, c); },
        [](Pixels& f, int w, int h, int c, PixelFormat t){ return f.allocate(w, h, c, t); }
    );
    pix_type["clear"] = &Pixels::clear;
    pix_type["isAllocated"] = &Pixels::isAllocated;
    pix_type["getWidth"] = &Pixels::getWidth;
    pix_type["getHeight"] = &Pixels::getHeight;
    pix_type["getChannels"] = &Pixels::getChannels;
    pix_type["getFormat"] = &Pixels::getFormat;
    pix_type["isFloat"] = &Pixels::isFloat;
    pix_type["getTotalBytes"] = &Pixels::getTotalBytes;
    pix_type["getData"] = [](Pixels& f) -> unsigned char* { return f.getData(); };
    pix_type["getDataF32"] = [](Pixels& f) -> float* { return f.getDataF32(); };
    pix_type["getDataVoid"] = [](Pixels& f) -> void* { return f.getDataVoid(); };
    pix_type["getColor"] = &Pixels::getColor;
    pix_type["setColor"] = &Pixels::setColor;
    pix_type["setFromPixels"] = &Pixels::setFromPixels;
    pix_type["setFromFloats"] = &Pixels::setFromFloats;
    pix_type["copyTo"] = &Pixels::copyTo;
    pix_type["clone"] = &Pixels::clone;
    pix_type["loadHDR"] = &Pixels::loadHDR;
    pix_type["loadPlatform"] = &Pixels::loadPlatform;
    pix_type["loadFromMemory"] = &Pixels::loadFromMemory;
    pix_type["load"] = sol::overload(
        &Pixels::load,
        [](Pixels& t, const std::string& s){ return t.load(s); }
    );
    pix_type["save"] = sol::overload(
        &Pixels::save,
        [](Pixels& t, const std::string& s){ return t.save(s); }
    );









    sol::usertype<Shader> shader_type = lua->new_usertype<Shader>("Shader",
        sol::constructors<Shader()>(),
        sol::call_constructor, sol::constructors<Shader()>() // FIXME: move constructor?
    );
    shader_type["load"] = &Shader::load;
    shader_type["clear"] = &Shader::clear;
    shader_type["isLoaded"] = &Shader::isLoaded;
    shader_type["begin"] = &Shader::begin;
    shader_type["end"] = &Shader::end;
    shader_type["end_shader"] = &Shader::end;
    shader_type["setUniform"] = sol::overload(
        [](Shader& f, int s, float v){ return f.setUniform(s, v); },
        [](Shader& f, int s, const Vec2& v){ return f.setUniform(s, v); },
        [](Shader& f, int s, const Vec3& v){ return f.setUniform(s, v); },
        [](Shader& f, int s, const Vec4& v){ return f.setUniform(s, v); },
        [](Shader& f, int s, const Color& v){ return f.setUniform(s, v); },
        [](Shader& f, int s, const std::vector<float>& v){ return f.setUniform(s, v); },
        [](Shader& f, int s, const std::vector<Vec2>& v){ return f.setUniform(s, v); },
        [](Shader& f, int s, const std::vector<Vec3>& v){ return f.setUniform(s, v); },
        [](Shader& f, int s, const std::vector<Vec4>& v){ return f.setUniform(s, v); },
        [](Shader& f, int s, const void* data, size_t size){ return f.setUniform(s, data, size); }
    );
    shader_type["setTexture"] = sol::overload(
        [](Shader& f, int s, sg_image i, sg_sampler p){ return f.setTexture(s, i, p); },
        [](Shader& f, int s, sg_view i, sg_sampler p){ return f.setTexture(s, i, p); }
    );
    shader_type["submitVertices"] = &Shader::submitVertices;

    sol::usertype<EasyCam> easycam_t = lua->new_usertype<EasyCam>("EasyCam",
        sol::constructors<EasyCam()>(),
        sol::call_constructor, sol::constructors<EasyCam()>()
    );

    easycam_t["begin"] = &EasyCam::begin;
    easycam_t["end"] = &EasyCam::end;
    easycam_t["end_cam"] = &EasyCam::end;
    easycam_t["reset"] = &EasyCam::reset;
    easycam_t["setTarget"] = sol::overload(
        [](EasyCam& m, float x, float y, float z){ return m.setTarget(x, y, z); },
        [](EasyCam& m, const Vec3& v){ return m.setTarget(v); }
    );
    easycam_t["getTarget"] = &EasyCam::getTarget;
    easycam_t["setUpAxis"] = sol::overload(
        [](EasyCam& m, float x, float y, float z){ return m.setUpAxis(x, y, z); },
        [](EasyCam& m, const Vec3& v){ return m.setUpAxis(v); }
    );
    easycam_t["getUpAxis"] = &EasyCam::getUpAxis;
    easycam_t["setDistance"] = &EasyCam::setDistance;
    easycam_t["getDistance"] = &EasyCam::getDistance;
    easycam_t["setFov"] = &EasyCam::setFov;
    easycam_t["getFov"] = &EasyCam::getFov;
    easycam_t["getPosition"] = &EasyCam::getPosition;
    easycam_t["setFovDeg"] = &EasyCam::setFovDeg;
    easycam_t["setNearClip"] = &EasyCam::setNearClip;
    easycam_t["setFarClip"] = &EasyCam::setFarClip;
    easycam_t["setSensitivity"] = &EasyCam::setSensitivity;
    easycam_t["setZoomSensitivity"] = &EasyCam::setZoomSensitivity;
    easycam_t["setPanSensitivity"] = &EasyCam::setPanSensitivity;
    easycam_t["setControlArea"] = &EasyCam::setControlArea;
    easycam_t["clearControlArea"] = &EasyCam::clearControlArea;
    easycam_t["enableMouseInput"] = &EasyCam::enableMouseInput;
    easycam_t["disableMouseInput"] = &EasyCam::disableMouseInput;
    easycam_t["isMouseInputEnabled"] = &EasyCam::isMouseInputEnabled;
    easycam_t["mousePressed"] = &EasyCam::mousePressed;
    easycam_t["mouseReleased"] = &EasyCam::mouseReleased;
    easycam_t["mouseDragged"] = &EasyCam::mouseDragged;
    easycam_t["mouseScrolled"] = &EasyCam::mouseScrolled;

    sol::usertype<Light> light_t = lua->new_usertype<Light>("Light",
        sol::constructors<Light()>(),
        sol::call_constructor, sol::constructors<Light()>()
    );
    light_t["setDirectional"] = sol::overload(
        [](Light& m, float x, float y, float z){ return m.setDirectional(x, y, z); },
        [](Light& m, const Vec3& v){ return m.setDirectional(v); }
    );
    light_t["setPoint"] = sol::overload(
        [](Light& m, float x, float y, float z){ return m.setPoint(x, y, z); },
        [](Light& m, const Vec3& v){ return m.setPoint(v); }
    );
    light_t["setSpot"] = sol::overload(
        [](Light& m, const Vec3& p, const Vec3& d){ return m.setSpot(p, d); },
        [](Light& m, const Vec3& p, const Vec3& d, float i){ return m.setSpot(p, d, i); },
        [](Light& m, const Vec3& p, const Vec3& d, float i, float o){ return m.setSpot(p, d, i, o); },
        [](Light& m, float a, float b, float c, float d, float e, float f){ return m.setSpot(a,b,c,d,e,f); },
        [](Light& m, float a, float b, float c, float d, float e, float f, float i){ return m.setSpot(a,b,c,d,e,f, i); },
        [](Light& m, float a, float b, float c, float d, float e, float f, float i, float o){ return m.setSpot(a,b,c,d,e,f, i,o); }
    );
    light_t["getSpotInnerCos"] = &Light::getSpotInnerCos;
    light_t["getSpotOuterCos"] = &Light::getSpotOuterCos;
    light_t["setProjectionTexture"] = &Light::setProjectionTexture;
    light_t["getProjectionTexture"] = &Light::getProjectionTexture;
    light_t["hasProjectionTexture"] = &Light::hasProjectionTexture;
    light_t["setLensShift"] = &Light::setLensShift;
    light_t["getLensShiftX"] = &Light::getLensShiftX;
    light_t["getLensShiftY"] = &Light::getLensShiftY;
    light_t["setProjectorAspect"] = &Light::setProjectorAspect;
    light_t["getProjectorAspect"] = &Light::getProjectorAspect;
    light_t["computeProjectorViewProj"] = sol::overload(
        [](Light& m){ return m.computeProjectorViewProj(); },
        [](Light& m, float a){ return m.computeProjectorViewProj(a); },
        [](Light& m, float a, float b){ return m.computeProjectorViewProj(a, b); }
    );
    light_t["setIesProfile"] = &Light::setIesProfile;
    light_t["getIesProfile"] = &Light::getIesProfile;
    light_t["hasIesProfile"] = &Light::hasIesProfile;
    light_t["enableShadow"] = &Light::enableShadow;
    light_t["disableShadow"] = &Light::disableShadow;
    light_t["isShadowEnabled"] = &Light::isShadowEnabled;
    light_t["getShadowResolution"] = &Light::getShadowResolution;
    light_t["setShadowBias"] = &Light::setShadowBias;
    light_t["getShadowBias"] = &Light::getShadowBias;
    light_t["setShadowSoftness"] = &Light::setShadowSoftness;
    light_t["getShadowSoftness"] = &Light::getShadowSoftness;
    light_t["setShadowSamples"] = &Light::setShadowSamples;
    light_t["getShadowSamples"] = &Light::getShadowSamples;
    light_t["setShadowArea"] = &Light::setShadowArea;
    light_t["getShadowAreaCenter"] = &Light::getShadowAreaCenter;
    light_t["getShadowAreaRadius"] = &Light::getShadowAreaRadius;
    light_t["computeShadowViewProj"] = &Light::computeShadowViewProj;
    light_t["getType"] = &Light::getType;
    light_t["getDirection"] = &Light::getDirection;
    light_t["getPosition"] = &Light::getPosition;
    light_t["setAmbient"] = sol::overload(
        [](Light& m, const Color& c){ return m.setAmbient(c); },
        [](Light& m, float a, float b, float c){ return m.setAmbient(a,b,c); },
        [](Light& m, float a, float b, float c, float d){ return m.setAmbient(a,b,c,d); }
    );
    light_t["setDiffuse"] = sol::overload(
        [](Light& m, const Color& c){ return m.setDiffuse(c); },
        [](Light& m, float a, float b, float c){ return m.setDiffuse(a,b,c); },
        [](Light& m, float a, float b, float c, float d){ return m.setDiffuse(a,b,c,d); }
    );
    light_t["setSpecular"] = sol::overload(
        [](Light& m, const Color& c){ return m.setSpecular(c); },
        [](Light& m, float a, float b, float c){ return m.setSpecular(a,b,c); },
        [](Light& m, float a, float b, float c, float d){ return m.setSpecular(a,b,c,d); }
    );
    light_t["getAmbient"] = &Light::getAmbient;
    light_t["getDiffuse"] = &Light::getDiffuse;
    light_t["getSpecular"] = &Light::getSpecular;
    light_t["getIntensity"] = &Light::getIntensity;
    light_t["setIntensity"] = &Light::setIntensity;

    light_t["setAttenuation"] = &Light::setAttenuation;
    light_t["getConstantAttenuation"] = &Light::getConstantAttenuation;
    light_t["getLinearAttenuation"] = &Light::getLinearAttenuation;
    light_t["getQuadraticAttenuation"] = &Light::getQuadraticAttenuation;
    light_t["enable"] = &Light::enable;
    light_t["disable"] = &Light::disable;
    light_t["isEnabled"] = &Light::isEnabled;
    light_t["calculate"] = &Light::calculate;


    sol::usertype<Material> material_t = lua->new_usertype<Material>("Material",
        sol::constructors<Material()>(),
        sol::call_constructor, sol::constructors<Material()>()
    );
    material_t["getBaseColor"] = &Material::getBaseColor;
    material_t["setBaseColor"] = sol::overload(
        [](Material& m, const Color& c){ return m.setBaseColor(c); },
        [](Material& m, float a, float b, float c){ return m.setBaseColor(a,b,c); },
        [](Material& m, float a, float b, float c, float d){ return m.setBaseColor(a,b,c,d); }
    );
    material_t["setMetallic"] = &Material::setMetallic;
    material_t["getMetallic"] = &Material::getMetallic;
    material_t["setRoughness"] = &Material::setRoughness;
    material_t["getRoughness"] = &Material::getRoughness;
    material_t["setAo"] = &Material::setAo;
    material_t["getAo"] = &Material::getAo;
    material_t["getEmissiveStrength"] = &Material::getEmissiveStrength;
    material_t["setEmissiveStrength"] = &Material::setEmissiveStrength;
    material_t["getEmissive"] = &Material::getEmissive;
    material_t["setEmissive"] = sol::overload(
        [](Material& m, const Color& c){ return m.setEmissive(c); },
        [](Material& m, float a, float b, float c){ return m.setEmissive(a,b,c); }
    );
    material_t["setMetallic"] = sol::var(&Material::setMetallic);
    material_t["gold"] = sol::var(&Material::gold);
    material_t["silver"] = sol::var(&Material::silver);
    material_t["copper"] = sol::var(&Material::copper);
    material_t["iron"] = sol::var(&Material::iron);
    material_t["bronze"] = sol::var(&Material::bronze);
    material_t["emerald"] = sol::var(&Material::emerald);
    material_t["ruby"] = sol::var(&Material::ruby);
    // FIXME: this makes error on runtime
    // material_t["plastic"] = sol::var(sol::overload(
    //     [](const Color& c, float r){ return Material::plastic(c, r); },
    //     [](const Color& c){ return Material::plastic(c); }
    // ));
    material_t["plastic"] = sol::var(&Material::plastic);
    material_t["rubber"] = sol::var(&Material::rubber);
    material_t["fromPhong"] = sol::overload(
        [](Material& m, const Color& d, const Color& p, float s){ return m.fromPhong(d, p, s); },
        [](Material& m, const Color& d, const Color& p, float s, const Color& e){ return m.fromPhong(d, p, s, e); }
    );
    material_t["setNormalMap"] = &Material::setNormalMap;
    material_t["getNormalMap"] = &Material::getNormalMap;
    material_t["hasNormalMap"] = &Material::hasNormalMap;

    material_t["setBaseColorTexture"] = &Material::setBaseColorTexture;
    material_t["getBaseColorTexture"] = &Material::getBaseColorTexture;
    material_t["hasBaseColorTexture"] = &Material::hasBaseColorTexture;
    material_t["setMetallicRoughnessTexture"] = &Material::setMetallicRoughnessTexture;
    material_t["getMetallicRoughnessTexture"] = &Material::getMetallicRoughnessTexture;
    material_t["hasMetallicRoughnessTexture"] = &Material::hasMetallicRoughnessTexture;
    material_t["setEmissiveTexture"] = &Material::setEmissiveTexture;
    material_t["getEmissiveTexture"] = &Material::getEmissiveTexture;
    material_t["hasEmissiveTexture"] = &Material::hasEmissiveTexture;
    material_t["setOcclusionTexture"] = &Material::setOcclusionTexture;
    material_t["getOcclusionTexture"] = &Material::getOcclusionTexture;
    material_t["hasOcclusionTexture"] = &Material::hasOcclusionTexture;

    // loadJson/saveJson/parseJson/toJsonString are free functions -> generated by
    // luagen in trussc_generated.cpp. Only the Json usertype is hand-written here.
    sol::usertype<Json> json_t = lua->new_usertype<Json>("Json",
        sol::constructors<Json()>(),
        sol::call_constructor, sol::constructors<Json()>(),
        "get_string", [](Json& j){ return j.get<std::string>(); },
        "get_double", [](Json& j){ return j.get<double>(); },
        "get_float", [](Json& j){ return j.get<float>(); },
        "get_int", [](Json& j){ return j.get<int>(); },
        "get_bool", [](Json& j){ return j.get<bool>(); },
        "empty", &Json::empty,
        "size", &Json::size,
        sol::meta_function::index, sol::overload(
            [](Json& j, size_t i){ return j[i]; },
            [](Json& j, const std::string& s){ return j[s]; }
        ),
        sol::meta_function::new_index, sol::overload(
            [](Json& j, size_t i, bool v){ return j[i] = v; },
            [](Json& j, size_t i, int v){ return j[i] = v; },
            [](Json& j, size_t i, float v){ return j[i] = v; },
            [](Json& j, size_t i, long v){ return j[i] = v; },
            [](Json& j, size_t i, double v){ return j[i] = v; },
            [](Json& j, size_t i, const std::string& v){ return j[i] = v; },
            [](Json& j, size_t i, const Json& v){ return j[i] = v; },
            // [](Json& j, size_t i, const sol::object& v){ return j[i] = v; },
            [](Json& j, const std::string& s, bool v){ return j[s] = v; },
            [](Json& j, const std::string& s, int v){ return j[s] = v; },
            [](Json& j, const std::string& s, float v){ return j[s] = v; },
            [](Json& j, const std::string& s, long v){ return j[s] = v; },
            [](Json& j, const std::string& s, double v){ return j[s] = v; },
            [](Json& j, const std::string& s, const std::string& v){ return j[s] = v; },
            [](Json& j, const std::string& s, const Json& v){ return j[s] = v; },
            [](Json& j, size_t i, const sol::table& tbl){
                json_new_index_table_fn(j, i, tbl);
            },
            [](Json& j, const std::string& i, const sol::table& tbl){
                json_new_index_table_fn(j, i, tbl);
            }
        )
    );

    // loadXml/parseXml are free functions -> generated by luagen. Xml usertype is hand-written.
    sol::usertype<Xml> xml_t = lua->new_usertype<Xml>("Xml",
        sol::constructors<Xml()>(),
        sol::call_constructor, sol::constructors<Xml()>(),
        "load", &Xml::load,
        "parse", &Xml::parse,
        "save", sol::overload(
            [](Xml& x, const std::string& s){ return x.save(s); },
            [](Xml& x, const std::string& s, const std::string& i){ return x.save(s, i); }
        ),
        "toString", sol::overload(
            [](Xml& x){ return x.toString(); },
            [](Xml& x, const std::string& i){ return x.toString(i); }
        ),
        "root", [](Xml& x){ return x.root(); },
        "addRoot", &Xml::addRoot,
        "child", &Xml::child,
        "document", [](Xml& x) -> XmlDocument& { return x.document(); },
        "empty", &Xml::empty,
        "addDeclaration", sol::overload(
            [](Xml& x){ return x.addDeclaration(); },
            [](Xml& x, const std::string& a){ return x.addDeclaration(a); },
            [](Xml& x, const std::string& a, const std::string& b){ return x.addDeclaration(a, b); }
        )
    );

    sol::usertype<XmlAttribute> xmlattr_t = lua->new_usertype<XmlAttribute>("XmlAttribute",
        sol::constructors<XmlAttribute()>(),
        sol::call_constructor, sol::constructors<XmlAttribute()>(),
        "set", sol::overload( // WORKAROUND
            [](XmlAttribute& x, pugi::string_view_t s){ return (x = s); },
            [](XmlAttribute& x, const pugi::char_t* s){ return (x = s); },
            [](XmlAttribute& x, int s){ return (x = s); },
            [](XmlAttribute& x, float s){ return (x = s); },
            [](XmlAttribute& x, long s){ return (x = s); }
        ),
        "name", &XmlAttribute::name,
        "value", &XmlAttribute::value
    );

    using XmlText = pugi::xml_text;

    sol::usertype<XmlText> xmltext_t = lua->new_usertype<XmlText>("XmlText",
        sol::constructors<XmlText()>(),
        sol::call_constructor, sol::constructors<XmlText()>(),
        "set", sol::overload( // WORKAROUND
            [](XmlText& x, pugi::string_view_t s){ return (x = s); },
            [](XmlText& x, const pugi::char_t* s){ return (x = s); },
            [](XmlText& x, int s){ return (x = s); },
            [](XmlText& x, float s){ return (x = s); },
            [](XmlText& x, long s){ return (x = s); }
        ),
        "get", &XmlText::get
    );

    sol::usertype<XmlNode> xmlnode_t = lua->new_usertype<XmlNode>("XmlNode",
        sol::constructors<XmlNode()>(),
        sol::call_constructor, sol::constructors<XmlNode()>(),
        "append_attribute", sol::overload(
            [](XmlNode& x, pugi::string_view_t n){ return x.append_attribute(n); },
            [](XmlNode& x, const pugi::char_t* n){ return x.append_attribute(n); }
        ),
        "prepend_attribute", sol::overload(
            [](XmlNode& x, pugi::string_view_t n){ return x.prepend_attribute(n); },
            [](XmlNode& x, const pugi::char_t* n){ return x.prepend_attribute(n); }
        ),
        "append_child", sol::overload(
            [](XmlNode& x, pugi::string_view_t n){ return x.append_child(n); },
            [](XmlNode& x, const pugi::char_t* n){ return x.append_child(n); }
        ),
        "prepend_child", sol::overload(
            [](XmlNode& x, pugi::string_view_t n){ return x.prepend_child(n); },
            [](XmlNode& x, const pugi::char_t* n){ return x.prepend_child(n); }
        ),
        "attribute", sol::overload(
            [](XmlNode& x, pugi::string_view_t n){ return x.attribute(n); },
            [](XmlNode& x, const pugi::char_t* n){ return x.attribute(n); }
        ),
        "child", sol::overload(
            [](XmlNode& x, pugi::string_view_t n){ return x.child(n); },
            [](XmlNode& x, const pugi::char_t* n){ return x.child(n); }
        ),
        "text", &XmlNode::text,
        "name", &XmlNode::name,
        "first_child", &XmlNode::first_child,
        "last_child", &XmlNode::last_child,
        "first_attribute", &XmlNode::first_attribute,
        "last_attribute", &XmlNode::last_attribute,
        "remove_children", &XmlNode::remove_children,
        // "children", [](XmlNode& x){ return x.children(); }
        "children", [lua](XmlNode& x){ // WORKAROUND for ipairs etc
            auto&& tbl = lua->create_table();
            for(auto&& n : x.children()){
                tbl.add(n);
            }
            return tbl;
        }
    );



    


    defineTween<Tween<float>, float>(lua, "TweenFloat");
    defineTween<Tween<Vec2>, Vec2>(lua, "TweenVec2");
    defineTween<Tween<Vec3>, Vec3>(lua, "TweenVec3");
    defineTween<Tween<Color>, Color>(lua, "TweenColor");

    // SoundSource — abstract base for SoundBuffer (eager) and SoundStream
    // (streaming). Lua-callable methods are the polymorphic ones (channels,
    // sampleRate, getDuration); to access SoundBuffer-specific methods,
    // pull a fresh SoundBuffer (Lua can construct one and call its load*
    // methods directly).
    lua->new_usertype<SoundSource>("SoundSource",
        sol::no_constructor,
        "channels", &SoundSource::channels,
        "sampleRate", &SoundSource::sampleRate,
        "getDuration", &SoundSource::getDuration,
        "kind", &SoundSource::kind
    );

    // SoundBuffer is registered below as a child of SoundSource via the
    // sol::bases<> hint so that shared_ptr<SoundSource> -> SoundBuffer
    // downcast works in Lua when needed.

    lua->new_usertype<SoundBuffer>("SoundBuffer",
        sol::constructors<SoundBuffer(),
            SoundBuffer(const SoundBuffer&), SoundBuffer(SoundBuffer&&)>(),
        sol::call_constructor, sol::constructors<SoundBuffer(),
            SoundBuffer(const SoundBuffer&), SoundBuffer(SoundBuffer&&)>(),
        sol::base_classes, sol::bases<SoundSource>(),
        "loadOgg", &SoundBuffer::loadOgg,
        "loadWav", &SoundBuffer::loadWav,
        "loadMp3", &SoundBuffer::loadMp3,
        "loadMp3FromMemory", &SoundBuffer::loadMp3FromMemory,
        "loadAac", &SoundBuffer::loadAac,
        "loadAacFromMemory", &SoundBuffer::loadAacFromMemory,
        "getAdtsSampleRateIndex", sol::var(&SoundBuffer::getAdtsSampleRateIndex),
        "createAdtsHeader", sol::var(&SoundBuffer::createAdtsHeader),
        "loadPcmFromMemory", &SoundBuffer::loadPcmFromMemory,
        "getDuration", &SoundBuffer::getDuration,
        "generateSineWave", &SoundBuffer::generateSineWave,
        "generateSquareWave", &SoundBuffer::generateSquareWave,
        "generateTriangleWave", &SoundBuffer::generateTriangleWave,
        "generateSawtoothWave", &SoundBuffer::generateSawtoothWave,
        "generateNoise", &SoundBuffer::generateNoise,
        "generatePinkNoise", &SoundBuffer::generatePinkNoise,
        "generateSilence", &SoundBuffer::generateSilence,
        "applyADSR", &SoundBuffer::applyADSR,
        "mixFrom", &SoundBuffer::mixFrom,
        "clip", &SoundBuffer::clip
    );

    lua->new_usertype<AudioEngine>("AudioEngine",
        "getInstance", sol::var(&AudioEngine::getInstance),
        // init() is overloaded — no-arg uses defaults, AudioSettings-arg
        // configures the engine. Resolve both for Lua.
        "init", sol::overload(
            static_cast<bool (AudioEngine::*)()>(&AudioEngine::init),
            static_cast<bool (AudioEngine::*)(const AudioSettings&)>(&AudioEngine::init)
        ),
        "shutdown", &AudioEngine::shutdown,
        "getAnalysisBuffer", &AudioEngine::getAnalysisBuffer,
        // play() now has two overloads (SoundSource and SoundBuffer);
        // resolve to the SoundSource one explicitly. The SoundBuffer
        // overload is reachable transparently by upcast in C++ but Lua
        // would error on "ambiguous member binding".
        "play", static_cast<std::shared_ptr<PlayingSound>(AudioEngine::*)(std::shared_ptr<SoundSource>)>(&AudioEngine::play),
        "mixAudio", &AudioEngine::mixAudio
    );

    // SoundStream — streaming source for long files. See SoundBuffer for
    // the eager counterpart used by short SFX.


    lua->new_usertype<MicInput>("MicInput",
        sol::constructors<MicInput>(),
        sol::call_constructor, sol::constructors<MicInput>(),
            // MicInput(const MicInput&), MicInput(MicInput&&)>(),
        "start", &MicInput::start,
        "stop", &MicInput::stop,
        "getBuffer", &MicInput::getBuffer,
        "isRunning", &MicInput::isRunning,
        "getSampleRate", &MicInput::getSampleRate,
        "onAudioData", &MicInput::onAudioData
    );
}


void tcxLua::setColorConstBindings(const std::shared_ptr<sol::state>& lua){
    // The `colors` table (colors.white etc.) is now GENERATED by luagen-types
    // from docs/reference/colors.json into trussctype_generated.cpp.
    (void)lua;
}

void tcxLua::setMathBindings(const std::shared_ptr<sol::state>& lua){
    // Most math (sin/cos/tan/atan/atan2/sqrt/acos/asin/exp/abs/log/ceil/floor/
    // round/pow/fmod/max/min) is now GENERATED by luagen in trussc_generated.cpp
    // (reference-data provider:"std"). Only the std math functions not yet present
    // in reference-data are kept hand-written here:
    lua->set_function("atanh", [](float v){ return atanh(v); });
    lua->set_function("tanh", [](float v){ return tanh(v); });
    lua->set_function("exp2", [](float v){ return exp2(v); });
    lua->set_function("log2", [](float v){ return log2(v); });
    lua->set_function("log10", [](float v){ return log10(v); });
    lua->set_function("trunc", [](float v){ return trunc(v); });
    lua->set_function("remainder", [](float a, float b){ return remainder(a, b); });
}

// } // namespace tcx::lua

#ifndef _MSC_VER
#pragma GCC diagnostic pop
#pragma clang diagnostic pop
#endif // #ifndef _MSC_VER
