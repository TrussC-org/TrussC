#pragma once
/*
    #version:1# (machine generated, don't edit!)

    Generated by sokol-shdc (https://github.com/floooh/sokol-tools)

    Cmdline:
        sokol-shdc --input /Users/toru/Nextcloud/Make/TrussC/TrussC/addons/tcxHap/src/shaders/ycocg.glsl --output /Users/toru/Nextcloud/Make/TrussC/TrussC/addons/tcxHap/src/shaders/ycocg.glsl.h --slang metal_macos:hlsl5:glsl300es:wgsl --format sokol

    Overview:
    =========
    Shader program: 'ycocg':
        Get shader desc: ycocg_shader_desc(sg_query_backend());
        Vertex Shader: vs_ycocg
        Fragment Shader: fs_ycocg
        Attributes:
            ATTR_ycocg_position => 0
            ATTR_ycocg_texcoord0 => 1
            ATTR_ycocg_color0 => 2
    Bindings:
        Uniform block 'vs_params':
            C struct: vs_params_t
            Bind slot: UB_vs_params => 0
        Texture 'tex':
            Image type: SG_IMAGETYPE_2D
            Sample type: SG_IMAGESAMPLETYPE_FLOAT
            Multisampled: false
            Bind slot: VIEW_tex => 0
        Sampler 'smp':
            Type: SG_SAMPLERTYPE_FILTERING
            Bind slot: SMP_smp => 0
*/
#if !defined(SOKOL_GFX_INCLUDED)
#error "Please include sokol_gfx.h before ycocg.glsl.h"
#endif
#if !defined(SOKOL_SHDC_ALIGN)
#if defined(_MSC_VER)
#define SOKOL_SHDC_ALIGN(a) __declspec(align(a))
#else
#define SOKOL_SHDC_ALIGN(a) __attribute__((aligned(a)))
#endif
#endif
#define ATTR_ycocg_position (0)
#define ATTR_ycocg_texcoord0 (1)
#define ATTR_ycocg_color0 (2)
#define UB_vs_params (0)
#define VIEW_tex (0)
#define SMP_smp (0)
#pragma pack(push,1)
SOKOL_SHDC_ALIGN(16) typedef struct vs_params_t {
    float screenSize[2];
    float _pad[2];
} vs_params_t;
#pragma pack(pop)
/*
    #version 300 es

    uniform vec4 vs_params[1];
    layout(location = 0) in vec3 position;
    out vec2 uv;
    layout(location = 1) in vec2 texcoord0;
    out vec4 vertColor;
    layout(location = 2) in vec4 color0;

    void main()
    {
        vec2 _28 = ((position.xy / vs_params[0].xy) * 2.0) - vec2(1.0);
        gl_Position = vec4(_28.x, -_28.y, position.z, 1.0);
        uv = texcoord0;
        vertColor = color0;
    }

*/
static const uint8_t vs_ycocg_source_glsl300es[380] = {
    0x23,0x76,0x65,0x72,0x73,0x69,0x6f,0x6e,0x20,0x33,0x30,0x30,0x20,0x65,0x73,0x0a,
    0x0a,0x75,0x6e,0x69,0x66,0x6f,0x72,0x6d,0x20,0x76,0x65,0x63,0x34,0x20,0x76,0x73,
    0x5f,0x70,0x61,0x72,0x61,0x6d,0x73,0x5b,0x31,0x5d,0x3b,0x0a,0x6c,0x61,0x79,0x6f,
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    0x63,0x6f,0x6c,0x6f,0x72,0x30,0x3b,0x0a,0x7d,0x0a,0x0a,0x00,
};
/*
    #version 300 es
    precision mediump float;
    precision highp int;

    uniform highp sampler2D tex_smp;

    in highp vec2 uv;
    layout(location = 0) out highp vec4 frag_color;
    in highp vec4 vertColor;

    void main()
    {
        highp vec4 _24 = texture(tex_smp, uv);
        highp float _34 = (_24.z * 31.875) + 1.0;
        highp float _49 = (_24.y - 0.5) / _34;
        highp float _53 = _24.w;
        frag_color = vec4((_53 + ((_24.x - 0.5) / _34)) - _49, _53 + _49, 1.0, 1.0) * vertColor;
    }

*/
static const uint8_t fs_ycocg_source_glsl300es[461] = {
    0x23,0x76,0x65,0x72,0x73,0x69,0x6f,0x6e,0x20,0x33,0x30,0x30,0x20,0x65,0x73,0x0a,
    0x70,0x72,0x65,0x63,0x69,0x73,0x69,0x6f,0x6e,0x20,0x6d,0x65,0x64,0x69,0x75,0x6d,
    0x70,0x20,0x66,0x6c,0x6f,0x61,0x74,0x3b,0x0a,0x70,0x72,0x65,0x63,0x69,0x73,0x69,
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    0x72,0x74,0x43,0x6f,0x6c,0x6f,0x72,0x3b,0x0a,0x7d,0x0a,0x0a,0x00,
};
/*
    cbuffer vs_params : register(b0)
    {
        float2 _17_screenSize : packoffset(c0);
        float2 _17_pad : packoffset(c0.z);
    };


    static float4 gl_Position;
    static float3 position;
    static float2 uv;
    static float2 texcoord0;
    static float4 vertColor;
    static float4 color0;

    struct SPIRV_Cross_Input
    {
        float3 position : TEXCOORD0;
        float2 texcoord0 : TEXCOORD1;
        float4 color0 : TEXCOORD2;
    };

    struct SPIRV_Cross_Output
    {
        float2 uv : TEXCOORD0;
        float4 vertColor : TEXCOORD1;
        float4 gl_Position : SV_Position;
    };

    void vert_main()
    {
        float2 _28 = ((position.xy / _17_screenSize) * 2.0f) - 1.0f.xx;
        gl_Position = float4(_28.x, -_28.y, position.z, 1.0f);
        uv = texcoord0;
        vertColor = color0;
    }

    SPIRV_Cross_Output main(SPIRV_Cross_Input stage_input)
    {
        position = stage_input.position;
        texcoord0 = stage_input.texcoord0;
        color0 = stage_input.color0;
        vert_main();
        SPIRV_Cross_Output stage_output;
        stage_output.gl_Position = gl_Position;
        stage_output.uv = uv;
        stage_output.vertColor = vertColor;
        return stage_output;
    }
*/
static const uint8_t vs_ycocg_source_hlsl5[1076] = {
    0x63,0x62,0x75,0x66,0x66,0x65,0x72,0x20,0x76,0x73,0x5f,0x70,0x61,0x72,0x61,0x6d,
    0x73,0x20,0x3a,0x20,0x72,0x65,0x67,0x69,0x73,0x74,0x65,0x72,0x28,0x62,0x30,0x29,
    0x0a,0x7b,0x0a,0x20,0x20,0x20,0x20,0x66,0x6c,0x6f,0x61,0x74,0x32,0x20,0x5f,0x31,
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    0x0a,0x7d,0x0a,0x00,
};
/*
    Texture2D<float4> tex : register(t0);
    SamplerState smp : register(s0);

    static float2 uv;
    static float4 frag_color;
    static float4 vertColor;

    struct SPIRV_Cross_Input
    {
        float2 uv : TEXCOORD0;
        float4 vertColor : TEXCOORD1;
    };

    struct SPIRV_Cross_Output
    {
        float4 frag_color : SV_Target0;
    };

    void frag_main()
    {
        float4 _24 = tex.Sample(smp, uv);
        float _34 = (_24.z * 31.875f) + 1.0f;
        float _49 = (_24.y - 0.5f) / _34;
        float _53 = _24.w;
        frag_color = float4((_53 + ((_24.x - 0.5f) / _34)) - _49, _53 + _49, 1.0f, 1.0f) * vertColor;
    }

    SPIRV_Cross_Output main(SPIRV_Cross_Input stage_input)
    {
        uv = stage_input.uv;
        vertColor = stage_input.vertColor;
        frag_main();
        SPIRV_Cross_Output stage_output;
        stage_output.frag_color = frag_color;
        return stage_output;
    }
*/
static const uint8_t fs_ycocg_source_hlsl5[808] = {
    0x54,0x65,0x78,0x74,0x75,0x72,0x65,0x32,0x44,0x3c,0x66,0x6c,0x6f,0x61,0x74,0x34,
    0x3e,0x20,0x74,0x65,0x78,0x20,0x3a,0x20,0x72,0x65,0x67,0x69,0x73,0x74,0x65,0x72,
    0x28,0x74,0x30,0x29,0x3b,0x0a,0x53,0x61,0x6d,0x70,0x6c,0x65,0x72,0x53,0x74,0x61,
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    0x70,0x75,0x74,0x3b,0x0a,0x7d,0x0a,0x00,
};
/*
    #include <metal_stdlib>
    #include <simd/simd.h>

    using namespace metal;

    struct vs_params
    {
        float2 screenSize;
        float2 _pad;
    };

    struct main0_out
    {
        float2 uv [[user(locn0)]];
        float4 vertColor [[user(locn1)]];
        float4 gl_Position [[position]];
    };

    struct main0_in
    {
        float3 position [[attribute(0)]];
        float2 texcoord0 [[attribute(1)]];
        float4 color0 [[attribute(2)]];
    };

    vertex main0_out main0(main0_in in [[stage_in]], constant vs_params& _17 [[buffer(0)]])
    {
        main0_out out = {};
        float2 _28 = ((in.position.xy / _17.screenSize) * 2.0) - float2(1.0);
        out.gl_Position = float4(_28.x, -_28.y, in.position.z, 1.0);
        out.uv = in.texcoord0;
        out.vertColor = in.color0;
        return out;
    }

*/
static const uint8_t vs_ycocg_source_metal_macos[730] = {
    0x23,0x69,0x6e,0x63,0x6c,0x75,0x64,0x65,0x20,0x3c,0x6d,0x65,0x74,0x61,0x6c,0x5f,
    0x73,0x74,0x64,0x6c,0x69,0x62,0x3e,0x0a,0x23,0x69,0x6e,0x63,0x6c,0x75,0x64,0x65,
    0x20,0x3c,0x73,0x69,0x6d,0x64,0x2f,0x73,0x69,0x6d,0x64,0x2e,0x68,0x3e,0x0a,0x0a,
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    0x20,0x6f,0x75,0x74,0x3b,0x0a,0x7d,0x0a,0x0a,0x00,
};
/*
    #include <metal_stdlib>
    #include <simd/simd.h>

    using namespace metal;

    struct main0_out
    {
        float4 frag_color [[color(0)]];
    };

    struct main0_in
    {
        float2 uv [[user(locn0)]];
        float4 vertColor [[user(locn1)]];
    };

    fragment main0_out main0(main0_in in [[stage_in]], texture2d<float> tex [[texture(0)]], sampler smp [[sampler(0)]])
    {
        main0_out out = {};
        float4 _24 = tex.sample(smp, in.uv);
        float _34 = (_24.z * 31.875) + 1.0;
        float _49 = (_24.y - 0.5) / _34;
        float _53 = _24.w;
        out.frag_color = float4((_53 + ((_24.x - 0.5) / _34)) - _49, _53 + _49, 1.0, 1.0) * in.vertColor;
        return out;
    }

*/
static const uint8_t fs_ycocg_source_metal_macos[627] = {
    0x23,0x69,0x6e,0x63,0x6c,0x75,0x64,0x65,0x20,0x3c,0x6d,0x65,0x74,0x61,0x6c,0x5f,
    0x73,0x74,0x64,0x6c,0x69,0x62,0x3e,0x0a,0x23,0x69,0x6e,0x63,0x6c,0x75,0x64,0x65,
    0x20,0x3c,0x73,0x69,0x6d,0x64,0x2f,0x73,0x69,0x6d,0x64,0x2e,0x68,0x3e,0x0a,0x0a,
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    0x0a,0x0a,0x00,
};
/*
    diagnostic(off, derivative_uniformity);

    struct vs_params {
      /_ @offset(0) _/
      screenSize : vec2f,
      /_ @offset(8) _/
      x_pad : vec2f,
    }

    var<private> position_1 : vec3f;

    @binding(0) @group(0) var<uniform> x_17 : vs_params;

    var<private> uv : vec2f;

    var<private> texcoord0 : vec2f;

    var<private> vertColor : vec4f;

    var<private> color0 : vec4f;

    var<private> gl_Position : vec4f;

    fn main_1() {
      var ndc : vec2f;
      ndc = (((position_1.xy / x_17.screenSize) * 2.0f) - vec2f(1.0f));
      ndc.y = -(ndc.y);
      gl_Position = vec4f(ndc.x, ndc.y, position_1.z, 1.0f);
      uv = texcoord0;
      vertColor = color0;
      return;
    }

    struct main_out {
      @builtin(position)
      gl_Position : vec4f,
      @location(0)
      uv_1 : vec2f,
      @location(1)
      vertColor_1 : vec4f,
    }

    @vertex
    fn main(@location(0) position_1_param : vec3f, @location(1) texcoord0_param : vec2f, @location(2) color0_param : vec4f) -> main_out {
      position_1 = position_1_param;
      texcoord0 = texcoord0_param;
      color0 = color0_param;
      main_1();
      return main_out(gl_Position, uv, vertColor);
    }
*/
static const uint8_t vs_ycocg_source_wgsl[1043] = {
    0x64,0x69,0x61,0x67,0x6e,0x6f,0x73,0x74,0x69,0x63,0x28,0x6f,0x66,0x66,0x2c,0x20,
    0x64,0x65,0x72,0x69,0x76,0x61,0x74,0x69,0x76,0x65,0x5f,0x75,0x6e,0x69,0x66,0x6f,
    0x72,0x6d,0x69,0x74,0x79,0x29,0x3b,0x0a,0x0a,0x73,0x74,0x72,0x75,0x63,0x74,0x20,
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    0x7d,0x0a,0x00,
};
/*
    diagnostic(off, derivative_uniformity);

    @binding(0) @group(1) var tex : texture_2d<f32>;

    @binding(32) @group(1) var smp : sampler;

    var<private> uv : vec2f;

    var<private> frag_color : vec4f;

    var<private> vertColor : vec4f;

    fn main_1() {
      var cocgsy : vec4f;
      var scale : f32;
      var Co : f32;
      var Cg : f32;
      var Y : f32;
      var R : f32;
      var G : f32;
      var B : f32;
      let x_23 = uv;
      let x_24 = textureSample(tex, smp, x_23);
      cocgsy = x_24;
      scale = ((cocgsy.z * 31.875f) + 1.0f);
      Co = ((cocgsy.x - 0.5f) / scale);
      Cg = ((cocgsy.y - 0.5f) / scale);
      Y = cocgsy.w;
      R = ((Y + Co) - Cg);
      G = (Y + Cg);
      B = ((Y - Co) - Cg);
      frag_color = (vec4f(R, G, 1.0f, 1.0f) * vertColor);
      return;
    }

    struct main_out {
      @location(0)
      frag_color_1 : vec4f,
    }

    @fragment
    fn main(@location(0) uv_param : vec2f, @location(1) vertColor_param : vec4f) -> main_out {
      uv = uv_param;
      vertColor = vertColor_param;
      main_1();
      return main_out(frag_color);
    }
*/
static const uint8_t fs_ycocg_source_wgsl[965] = {
    0x64,0x69,0x61,0x67,0x6e,0x6f,0x73,0x74,0x69,0x63,0x28,0x6f,0x66,0x66,0x2c,0x20,
    0x64,0x65,0x72,0x69,0x76,0x61,0x74,0x69,0x76,0x65,0x5f,0x75,0x6e,0x69,0x66,0x6f,
    0x72,0x6d,0x69,0x74,0x79,0x29,0x3b,0x0a,0x0a,0x40,0x62,0x69,0x6e,0x64,0x69,0x6e,
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    0x3b,0x0a,0x7d,0x0a,0x00,
};
static inline const sg_shader_desc* ycocg_shader_desc(sg_backend backend) {
    if (backend == SG_BACKEND_GLES3) {
        static sg_shader_desc desc;
        static bool valid;
        if (!valid) {
            valid = true;
            desc.vertex_func.source = (const char*)vs_ycocg_source_glsl300es;
            desc.vertex_func.entry = "main";
            desc.fragment_func.source = (const char*)fs_ycocg_source_glsl300es;
            desc.fragment_func.entry = "main";
            desc.attrs[0].base_type = SG_SHADERATTRBASETYPE_FLOAT;
            desc.attrs[0].glsl_name = "position";
            desc.attrs[1].base_type = SG_SHADERATTRBASETYPE_FLOAT;
            desc.attrs[1].glsl_name = "texcoord0";
            desc.attrs[2].base_type = SG_SHADERATTRBASETYPE_FLOAT;
            desc.attrs[2].glsl_name = "color0";
            desc.uniform_blocks[0].stage = SG_SHADERSTAGE_VERTEX;
            desc.uniform_blocks[0].layout = SG_UNIFORMLAYOUT_STD140;
            desc.uniform_blocks[0].size = 16;
            desc.uniform_blocks[0].glsl_uniforms[0].type = SG_UNIFORMTYPE_FLOAT4;
            desc.uniform_blocks[0].glsl_uniforms[0].array_count = 1;
            desc.uniform_blocks[0].glsl_uniforms[0].glsl_name = "vs_params";
            desc.views[0].texture.stage = SG_SHADERSTAGE_FRAGMENT;
            desc.views[0].texture.image_type = SG_IMAGETYPE_2D;
            desc.views[0].texture.sample_type = SG_IMAGESAMPLETYPE_FLOAT;
            desc.views[0].texture.multisampled = false;
            desc.samplers[0].stage = SG_SHADERSTAGE_FRAGMENT;
            desc.samplers[0].sampler_type = SG_SAMPLERTYPE_FILTERING;
            desc.texture_sampler_pairs[0].stage = SG_SHADERSTAGE_FRAGMENT;
            desc.texture_sampler_pairs[0].view_slot = 0;
            desc.texture_sampler_pairs[0].sampler_slot = 0;
            desc.texture_sampler_pairs[0].glsl_name = "tex_smp";
            desc.label = "ycocg_shader";
        }
        return &desc;
    }
    if (backend == SG_BACKEND_D3D11) {
        static sg_shader_desc desc;
        static bool valid;
        if (!valid) {
            valid = true;
            desc.vertex_func.source = (const char*)vs_ycocg_source_hlsl5;
            desc.vertex_func.d3d11_target = "vs_5_0";
            desc.vertex_func.entry = "main";
            desc.fragment_func.source = (const char*)fs_ycocg_source_hlsl5;
            desc.fragment_func.d3d11_target = "ps_5_0";
            desc.fragment_func.entry = "main";
            desc.attrs[0].base_type = SG_SHADERATTRBASETYPE_FLOAT;
            desc.attrs[0].hlsl_sem_name = "TEXCOORD";
            desc.attrs[0].hlsl_sem_index = 0;
            desc.attrs[1].base_type = SG_SHADERATTRBASETYPE_FLOAT;
            desc.attrs[1].hlsl_sem_name = "TEXCOORD";
            desc.attrs[1].hlsl_sem_index = 1;
            desc.attrs[2].base_type = SG_SHADERATTRBASETYPE_FLOAT;
            desc.attrs[2].hlsl_sem_name = "TEXCOORD";
            desc.attrs[2].hlsl_sem_index = 2;
            desc.uniform_blocks[0].stage = SG_SHADERSTAGE_VERTEX;
            desc.uniform_blocks[0].layout = SG_UNIFORMLAYOUT_STD140;
            desc.uniform_blocks[0].size = 16;
            desc.uniform_blocks[0].hlsl_register_b_n = 0;
            desc.views[0].texture.stage = SG_SHADERSTAGE_FRAGMENT;
            desc.views[0].texture.image_type = SG_IMAGETYPE_2D;
            desc.views[0].texture.sample_type = SG_IMAGESAMPLETYPE_FLOAT;
            desc.views[0].texture.multisampled = false;
            desc.views[0].texture.hlsl_register_t_n = 0;
            desc.samplers[0].stage = SG_SHADERSTAGE_FRAGMENT;
            desc.samplers[0].sampler_type = SG_SAMPLERTYPE_FILTERING;
            desc.samplers[0].hlsl_register_s_n = 0;
            desc.texture_sampler_pairs[0].stage = SG_SHADERSTAGE_FRAGMENT;
            desc.texture_sampler_pairs[0].view_slot = 0;
            desc.texture_sampler_pairs[0].sampler_slot = 0;
            desc.label = "ycocg_shader";
        }
        return &desc;
    }
    if (backend == SG_BACKEND_METAL_MACOS) {
        static sg_shader_desc desc;
        static bool valid;
        if (!valid) {
            valid = true;
            desc.vertex_func.source = (const char*)vs_ycocg_source_metal_macos;
            desc.vertex_func.entry = "main0";
            desc.fragment_func.source = (const char*)fs_ycocg_source_metal_macos;
            desc.fragment_func.entry = "main0";
            desc.attrs[0].base_type = SG_SHADERATTRBASETYPE_FLOAT;
            desc.attrs[1].base_type = SG_SHADERATTRBASETYPE_FLOAT;
            desc.attrs[2].base_type = SG_SHADERATTRBASETYPE_FLOAT;
            desc.uniform_blocks[0].stage = SG_SHADERSTAGE_VERTEX;
            desc.uniform_blocks[0].layout = SG_UNIFORMLAYOUT_STD140;
            desc.uniform_blocks[0].size = 16;
            desc.uniform_blocks[0].msl_buffer_n = 0;
            desc.views[0].texture.stage = SG_SHADERSTAGE_FRAGMENT;
            desc.views[0].texture.image_type = SG_IMAGETYPE_2D;
            desc.views[0].texture.sample_type = SG_IMAGESAMPLETYPE_FLOAT;
            desc.views[0].texture.multisampled = false;
            desc.views[0].texture.msl_texture_n = 0;
            desc.samplers[0].stage = SG_SHADERSTAGE_FRAGMENT;
            desc.samplers[0].sampler_type = SG_SAMPLERTYPE_FILTERING;
            desc.samplers[0].msl_sampler_n = 0;
            desc.texture_sampler_pairs[0].stage = SG_SHADERSTAGE_FRAGMENT;
            desc.texture_sampler_pairs[0].view_slot = 0;
            desc.texture_sampler_pairs[0].sampler_slot = 0;
            desc.label = "ycocg_shader";
        }
        return &desc;
    }
    if (backend == SG_BACKEND_WGPU) {
        static sg_shader_desc desc;
        static bool valid;
        if (!valid) {
            valid = true;
            desc.vertex_func.source = (const char*)vs_ycocg_source_wgsl;
            desc.vertex_func.entry = "main";
            desc.fragment_func.source = (const char*)fs_ycocg_source_wgsl;
            desc.fragment_func.entry = "main";
            desc.attrs[0].base_type = SG_SHADERATTRBASETYPE_FLOAT;
            desc.attrs[1].base_type = SG_SHADERATTRBASETYPE_FLOAT;
            desc.attrs[2].base_type = SG_SHADERATTRBASETYPE_FLOAT;
            desc.uniform_blocks[0].stage = SG_SHADERSTAGE_VERTEX;
            desc.uniform_blocks[0].layout = SG_UNIFORMLAYOUT_STD140;
            desc.uniform_blocks[0].size = 16;
            desc.uniform_blocks[0].wgsl_group0_binding_n = 0;
            desc.views[0].texture.stage = SG_SHADERSTAGE_FRAGMENT;
            desc.views[0].texture.image_type = SG_IMAGETYPE_2D;
            desc.views[0].texture.sample_type = SG_IMAGESAMPLETYPE_FLOAT;
            desc.views[0].texture.multisampled = false;
            desc.views[0].texture.wgsl_group1_binding_n = 0;
            desc.samplers[0].stage = SG_SHADERSTAGE_FRAGMENT;
            desc.samplers[0].sampler_type = SG_SAMPLERTYPE_FILTERING;
            desc.samplers[0].wgsl_group1_binding_n = 32;
            desc.texture_sampler_pairs[0].stage = SG_SHADERSTAGE_FRAGMENT;
            desc.texture_sampler_pairs[0].view_slot = 0;
            desc.texture_sampler_pairs[0].sampler_slot = 0;
            desc.label = "ycocg_shader";
        }
        return &desc;
    }
    return 0;
}
