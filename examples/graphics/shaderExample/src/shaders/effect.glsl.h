#pragma once
/*
    #version:1# (machine generated, don't edit!)

    Generated by sokol-shdc (https://github.com/floooh/sokol-tools)

    Cmdline:
        sokol-shdc -i /Users/toru/Nextcloud/Make/TrussC/TrussC/examples/graphics/shaderExample/src/shaders/effect.glsl -o /Users/toru/Nextcloud/Make/TrussC/TrussC/examples/graphics/shaderExample/src/shaders/effect.glsl.h -l metal_macos:hlsl5:glsl300es:wgsl --ifdef

    Overview:
    =========
    Shader program: 'rainbow':
        Get shader desc: rainbow_shader_desc(sg_query_backend());
        Vertex Shader: vs_effect
        Fragment Shader: fs_rainbow
        Attributes:
            ATTR_rainbow_position => 0
            ATTR_rainbow_texcoord0 => 1
            ATTR_rainbow_color0 => 2
    Bindings:
        Uniform block 'vs_params':
            C struct: vs_params_t
            Bind slot: UB_vs_params => 1
        Uniform block 'effect_params':
            C struct: effect_params_t
            Bind slot: UB_effect_params => 0
*/
#if !defined(SOKOL_GFX_INCLUDED)
#error "Please include sokol_gfx.h before effect.glsl.h"
#endif
#if !defined(SOKOL_SHDC_ALIGN)
#if defined(_MSC_VER)
#define SOKOL_SHDC_ALIGN(a) __declspec(align(a))
#else
#define SOKOL_SHDC_ALIGN(a) __attribute__((aligned(a)))
#endif
#endif
#define ATTR_rainbow_position (0)
#define ATTR_rainbow_texcoord0 (1)
#define ATTR_rainbow_color0 (2)
#define UB_vs_params (1)
#define UB_effect_params (0)
#pragma pack(push,1)
SOKOL_SHDC_ALIGN(16) typedef struct vs_params_t {
    float screenSize[2];
    float _pad[2];
} vs_params_t;
#pragma pack(pop)
#pragma pack(push,1)
SOKOL_SHDC_ALIGN(16) typedef struct effect_params_t {
    float time;
    float effectStrength;
    float _pad0;
    float _pad1;
} effect_params_t;
#pragma pack(pop)
/*
    #version 300 es

    uniform vec4 vs_params[1];
    layout(location = 0) in vec3 position;
    out vec2 uv;
    layout(location = 1) in vec2 texcoord0;
    out vec4 vertColor;
    layout(location = 2) in vec4 color0;

    void main()
    {
        vec2 _28 = ((position.xy / vs_params[0].xy) * 2.0) - vec2(1.0);
        gl_Position = vec4(_28.x, -_28.y, position.z, 1.0);
        uv = texcoord0;
        vertColor = color0;
    }

*/
#if defined(SOKOL_GLES3)
static const uint8_t vs_effect_source_glsl300es[380] = {
    0x23,0x76,0x65,0x72,0x73,0x69,0x6f,0x6e,0x20,0x33,0x30,0x30,0x20,0x65,0x73,0x0a,
    0x0a,0x75,0x6e,0x69,0x66,0x6f,0x72,0x6d,0x20,0x76,0x65,0x63,0x34,0x20,0x76,0x73,
    0x5f,0x70,0x61,0x72,0x61,0x6d,0x73,0x5b,0x31,0x5d,0x3b,0x0a,0x6c,0x61,0x79,0x6f,
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    0x63,0x6f,0x6c,0x6f,0x72,0x30,0x3b,0x0a,0x7d,0x0a,0x0a,0x00,
};
#endif
/*
    #version 300 es
    precision mediump float;
    precision highp int;

    uniform highp vec4 effect_params[1];
    in highp vec4 vertColor;
    layout(location = 0) out highp vec4 frag_color;
    in highp vec2 uv;

    highp vec3 hsv2rgb(highp vec3 c)
    {
        return mix(vec3(1.0), clamp(abs((fract(c.xxx + vec3(1.0, 0.666666686534881591796875, 0.3333333432674407958984375)) * 6.0) - vec3(3.0)) - vec3(1.0), vec3(0.0), vec3(1.0)), vec3(c.y)) * c.z;
    }

    void main()
    {
        highp vec3 param = vec3(fract((0.0030000000260770320892333984375 * (gl_FragCoord.x + gl_FragCoord.y)) + (effect_params[0].x * 0.5)), 0.800000011920928955078125, 1.0);
        frag_color = vec4(mix(vertColor.xyz, hsv2rgb(param), vec3(effect_params[0].y)), vertColor.w);
    }

*/
#if defined(SOKOL_GLES3)
static const uint8_t fs_rainbow_source_glsl300es[710] = {
    0x23,0x76,0x65,0x72,0x73,0x69,0x6f,0x6e,0x20,0x33,0x30,0x30,0x20,0x65,0x73,0x0a,
    0x70,0x72,0x65,0x63,0x69,0x73,0x69,0x6f,0x6e,0x20,0x6d,0x65,0x64,0x69,0x75,0x6d,
    0x70,0x20,0x66,0x6c,0x6f,0x61,0x74,0x3b,0x0a,0x70,0x72,0x65,0x63,0x69,0x73,0x69,
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    0x3b,0x0a,0x7d,0x0a,0x0a,0x00,
};
#endif
/*
    cbuffer vs_params : register(b1)
    {
        float2 _17_screenSize : packoffset(c0);
        float2 _17_pad : packoffset(c0.z);
    };


    static float4 gl_Position;
    static float3 position;
    static float2 uv;
    static float2 texcoord0;
    static float4 vertColor;
    static float4 color0;

    struct SPIRV_Cross_Input
    {
        float3 position : TEXCOORD0;
        float2 texcoord0 : TEXCOORD1;
        float4 color0 : TEXCOORD2;
    };

    struct SPIRV_Cross_Output
    {
        float2 uv : TEXCOORD0;
        float4 vertColor : TEXCOORD1;
        float4 gl_Position : SV_Position;
    };

    void vert_main()
    {
        float2 _28 = ((position.xy / _17_screenSize) * 2.0f) - 1.0f.xx;
        gl_Position = float4(_28.x, -_28.y, position.z, 1.0f);
        uv = texcoord0;
        vertColor = color0;
    }

    SPIRV_Cross_Output main(SPIRV_Cross_Input stage_input)
    {
        position = stage_input.position;
        texcoord0 = stage_input.texcoord0;
        color0 = stage_input.color0;
        vert_main();
        SPIRV_Cross_Output stage_output;
        stage_output.gl_Position = gl_Position;
        stage_output.uv = uv;
        stage_output.vertColor = vertColor;
        return stage_output;
    }
*/
#if defined(SOKOL_D3D11)
static const uint8_t vs_effect_source_hlsl5[1076] = {
    0x63,0x62,0x75,0x66,0x66,0x65,0x72,0x20,0x76,0x73,0x5f,0x70,0x61,0x72,0x61,0x6d,
    0x73,0x20,0x3a,0x20,0x72,0x65,0x67,0x69,0x73,0x74,0x65,0x72,0x28,0x62,0x31,0x29,
    0x0a,0x7b,0x0a,0x20,0x20,0x20,0x20,0x66,0x6c,0x6f,0x61,0x74,0x32,0x20,0x5f,0x31,
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    0x0a,0x7d,0x0a,0x00,
};
#endif
/*
    cbuffer effect_params : register(b0)
    {
        float _72_time : packoffset(c0);
        float _72_effectStrength : packoffset(c0.y);
        float _72_pad0 : packoffset(c0.z);
        float _72_pad1 : packoffset(c0.w);
    };


    static float4 gl_FragCoord;
    static float4 vertColor;
    static float4 frag_color;
    static float2 uv;

    struct SPIRV_Cross_Input
    {
        float2 uv : TEXCOORD0;
        float4 vertColor : TEXCOORD1;
        float4 gl_FragCoord : SV_Position;
    };

    struct SPIRV_Cross_Output
    {
        float4 frag_color : SV_Target0;
    };

    float3 hsv2rgb(float3 c)
    {
        return lerp(1.0f.xxx, clamp(abs((frac(c.xxx + float3(1.0f, 0.666666686534881591796875f, 0.3333333432674407958984375f)) * 6.0f) - 3.0f.xxx) - 1.0f.xxx, 0.0f.xxx, 1.0f.xxx), c.y.xxx) * c.z;
    }

    void frag_main()
    {
        float3 param = float3(frac((0.0030000000260770320892333984375f * (gl_FragCoord.x + gl_FragCoord.y)) + (_72_time * 0.5f)), 0.800000011920928955078125f, 1.0f);
        frag_color = float4(lerp(vertColor.xyz, hsv2rgb(param), _72_effectStrength.xxx), vertColor.w);
    }

    SPIRV_Cross_Output main(SPIRV_Cross_Input stage_input)
    {
        gl_FragCoord = stage_input.gl_FragCoord;
        gl_FragCoord.w = 1.0 / gl_FragCoord.w;
        vertColor = stage_input.vertColor;
        uv = stage_input.uv;
        frag_main();
        SPIRV_Cross_Output stage_output;
        stage_output.frag_color = frag_color;
        return stage_output;
    }
*/
#if defined(SOKOL_D3D11)
static const uint8_t fs_rainbow_source_hlsl5[1343] = {
    0x63,0x62,0x75,0x66,0x66,0x65,0x72,0x20,0x65,0x66,0x66,0x65,0x63,0x74,0x5f,0x70,
    0x61,0x72,0x61,0x6d,0x73,0x20,0x3a,0x20,0x72,0x65,0x67,0x69,0x73,0x74,0x65,0x72,
    0x28,0x62,0x30,0x29,0x0a,0x7b,0x0a,0x20,0x20,0x20,0x20,0x66,0x6c,0x6f,0x61,0x74,
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    0x61,0x67,0x65,0x5f,0x6f,0x75,0x74,0x70,0x75,0x74,0x3b,0x0a,0x7d,0x0a,0x00,
};
#endif
/*
    #include <metal_stdlib>
    #include <simd/simd.h>

    using namespace metal;

    struct vs_params
    {
        float2 screenSize;
        float2 _pad;
    };

    struct main0_out
    {
        float2 uv [[user(locn0)]];
        float4 vertColor [[user(locn1)]];
        float4 gl_Position [[position]];
    };

    struct main0_in
    {
        float3 position [[attribute(0)]];
        float2 texcoord0 [[attribute(1)]];
        float4 color0 [[attribute(2)]];
    };

    vertex main0_out main0(main0_in in [[stage_in]], constant vs_params& _17 [[buffer(1)]])
    {
        main0_out out = {};
        float2 _28 = ((in.position.xy / _17.screenSize) * 2.0) - float2(1.0);
        out.gl_Position = float4(_28.x, -_28.y, in.position.z, 1.0);
        out.uv = in.texcoord0;
        out.vertColor = in.color0;
        return out;
    }

*/
#if defined(SOKOL_METAL)
static const uint8_t vs_effect_source_metal_macos[730] = {
    0x23,0x69,0x6e,0x63,0x6c,0x75,0x64,0x65,0x20,0x3c,0x6d,0x65,0x74,0x61,0x6c,0x5f,
    0x73,0x74,0x64,0x6c,0x69,0x62,0x3e,0x0a,0x23,0x69,0x6e,0x63,0x6c,0x75,0x64,0x65,
    0x20,0x3c,0x73,0x69,0x6d,0x64,0x2f,0x73,0x69,0x6d,0x64,0x2e,0x68,0x3e,0x0a,0x0a,
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    0x20,0x6f,0x75,0x74,0x3b,0x0a,0x7d,0x0a,0x0a,0x00,
};
#endif
/*
    #pragma clang diagnostic ignored "-Wmissing-prototypes"

    #include <metal_stdlib>
    #include <simd/simd.h>

    using namespace metal;

    struct effect_params
    {
        float time;
        float effectStrength;
        float _pad0;
        float _pad1;
    };

    struct main0_out
    {
        float4 frag_color [[color(0)]];
    };

    struct main0_in
    {
        float4 vertColor [[user(locn1)]];
    };

    static inline __attribute__((always_inline))
    float3 hsv2rgb(thread const float3& c)
    {
        return mix(float3(1.0), fast::clamp(abs((fract(c.xxx + float3(1.0, 0.666666686534881591796875, 0.3333333432674407958984375)) * 6.0) - float3(3.0)) - float3(1.0), float3(0.0), float3(1.0)), float3(c.y)) * c.z;
    }

    fragment main0_out main0(main0_in in [[stage_in]], constant effect_params& _72 [[buffer(0)]], float4 gl_FragCoord [[position]])
    {
        main0_out out = {};
        float3 param = float3(fract((0.0030000000260770320892333984375 * (gl_FragCoord.x + gl_FragCoord.y)) + (_72.time * 0.5)), 0.800000011920928955078125, 1.0);
        out.frag_color = float4(mix(in.vertColor.xyz, hsv2rgb(param), float3(_72.effectStrength)), in.vertColor.w);
        return out;
    }

*/
#if defined(SOKOL_METAL)
static const uint8_t fs_rainbow_source_metal_macos[1098] = {
    0x23,0x70,0x72,0x61,0x67,0x6d,0x61,0x20,0x63,0x6c,0x61,0x6e,0x67,0x20,0x64,0x69,
    0x61,0x67,0x6e,0x6f,0x73,0x74,0x69,0x63,0x20,0x69,0x67,0x6e,0x6f,0x72,0x65,0x64,
    0x20,0x22,0x2d,0x57,0x6d,0x69,0x73,0x73,0x69,0x6e,0x67,0x2d,0x70,0x72,0x6f,0x74,
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    0x20,0x6f,0x75,0x74,0x3b,0x0a,0x7d,0x0a,0x0a,0x00,
};
#endif
/*
    diagnostic(off, derivative_uniformity);

    struct vs_params {
      /_ @offset(0) _/
      screenSize : vec2f,
      /_ @offset(8) _/
      x_pad : vec2f,
    }

    var<private> position_1 : vec3f;

    @binding(1) @group(0) var<uniform> x_17 : vs_params;

    var<private> uv : vec2f;

    var<private> texcoord0 : vec2f;

    var<private> vertColor : vec4f;

    var<private> color0 : vec4f;

    var<private> gl_Position : vec4f;

    fn main_1() {
      var ndc : vec2f;
      ndc = (((position_1.xy / x_17.screenSize) * 2.0f) - vec2f(1.0f));
      ndc.y = -(ndc.y);
      gl_Position = vec4f(ndc.x, ndc.y, position_1.z, 1.0f);
      uv = texcoord0;
      vertColor = color0;
      return;
    }

    struct main_out {
      @builtin(position)
      gl_Position : vec4f,
      @location(0)
      uv_1 : vec2f,
      @location(1)
      vertColor_1 : vec4f,
    }

    @vertex
    fn main(@location(0) position_1_param : vec3f, @location(1) texcoord0_param : vec2f, @location(2) color0_param : vec4f) -> main_out {
      position_1 = position_1_param;
      texcoord0 = texcoord0_param;
      color0 = color0_param;
      main_1();
      return main_out(gl_Position, uv, vertColor);
    }
*/
#if defined(SOKOL_WGPU)
static const uint8_t vs_effect_source_wgsl[1043] = {
    0x64,0x69,0x61,0x67,0x6e,0x6f,0x73,0x74,0x69,0x63,0x28,0x6f,0x66,0x66,0x2c,0x20,
    0x64,0x65,0x72,0x69,0x76,0x61,0x74,0x69,0x76,0x65,0x5f,0x75,0x6e,0x69,0x66,0x6f,
    0x72,0x6d,0x69,0x74,0x79,0x29,0x3b,0x0a,0x0a,0x73,0x74,0x72,0x75,0x63,0x74,0x20,
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    0x7d,0x0a,0x00,
};
#endif
/*
    diagnostic(off, derivative_uniformity);

    struct effect_params {
      /_ @offset(0) _/
      time : f32,
      /_ @offset(4) _/
      effectStrength : f32,
      /_ @offset(8) _/
      x_pad0 : f32,
      /_ @offset(12) _/
      x_pad1 : f32,
    }

    var<private> gl_FragCoord : vec4f;

    @binding(0) @group(0) var<uniform> x_72 : effect_params;

    var<private> vertColor : vec4f;

    var<private> frag_color : vec4f;

    var<private> uv : vec2f;

    fn hsv2rgb_vf3_(c : ptr<function, vec3f>) -> vec3f {
      var K : vec4f;
      var p : vec3f;
      K = vec4f(1.0f, 0.6666666865348815918f, 0.3333333432674407959f, 3.0f);
      p = abs(((fract(((*(c)).xxx + K.xyz)) * 6.0f) - K.www));
      let x_38 = (*(c)).z;
      let x_39 = K;
      let x_41 = p;
      let x_42 = K;
      let x_51 = (*(c)).y;
      return (mix(x_39.xxx, clamp((x_41 - x_42.xxx), vec3f(0.0f), vec3f(1.0f)), vec3f(x_51)) * x_38);
    }

    fn main_1() {
      var hue : f32;
      var rainbow : vec3f;
      var param : vec3f;
      var finalColor : vec3f;
      hue = fract((((gl_FragCoord.x * 0.00300000002607703209f) + (gl_FragCoord.y * 0.00300000002607703209f)) + (x_72.time * 0.5f)));
      param = vec3f(hue, 0.80000001192092895508f, 1.0f);
      let x_87 = hsv2rgb_vf3_(&(param));
      rainbow = x_87;
      finalColor = mix(vertColor.xyz, rainbow, vec3f(x_72.effectStrength));
      frag_color = vec4f(finalColor.x, finalColor.y, finalColor.z, vertColor.w);
      return;
    }

    struct main_out {
      @location(0)
      frag_color_1 : vec4f,
    }

    @fragment
    fn main(@builtin(position) gl_FragCoord_param : vec4f, @location(1) vertColor_param : vec4f, @location(0) uv_param : vec2f) -> main_out {
      gl_FragCoord = gl_FragCoord_param;
      vertColor = vertColor_param;
      uv = uv_param;
      main_1();
      return main_out(frag_color);
    }
*/
#if defined(SOKOL_WGPU)
static const uint8_t fs_rainbow_source_wgsl[1654] = {
    0x64,0x69,0x61,0x67,0x6e,0x6f,0x73,0x74,0x69,0x63,0x28,0x6f,0x66,0x66,0x2c,0x20,
    0x64,0x65,0x72,0x69,0x76,0x61,0x74,0x69,0x76,0x65,0x5f,0x75,0x6e,0x69,0x66,0x6f,
    0x72,0x6d,0x69,0x74,0x79,0x29,0x3b,0x0a,0x0a,0x73,0x74,0x72,0x75,0x63,0x74,0x20,
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    0x29,0x3b,0x0a,0x7d,0x0a,0x00,
};
#endif
static inline const sg_shader_desc* rainbow_shader_desc(sg_backend backend) {
    #if defined(SOKOL_GLES3)
    if (backend == SG_BACKEND_GLES3) {
        static sg_shader_desc desc;
        static bool valid;
        if (!valid) {
            valid = true;
            desc.vertex_func.source = (const char*)vs_effect_source_glsl300es;
            desc.vertex_func.entry = "main";
            desc.fragment_func.source = (const char*)fs_rainbow_source_glsl300es;
            desc.fragment_func.entry = "main";
            desc.attrs[0].base_type = SG_SHADERATTRBASETYPE_FLOAT;
            desc.attrs[0].glsl_name = "position";
            desc.attrs[1].base_type = SG_SHADERATTRBASETYPE_FLOAT;
            desc.attrs[1].glsl_name = "texcoord0";
            desc.attrs[2].base_type = SG_SHADERATTRBASETYPE_FLOAT;
            desc.attrs[2].glsl_name = "color0";
            desc.uniform_blocks[0].stage = SG_SHADERSTAGE_FRAGMENT;
            desc.uniform_blocks[0].layout = SG_UNIFORMLAYOUT_STD140;
            desc.uniform_blocks[0].size = 16;
            desc.uniform_blocks[0].glsl_uniforms[0].type = SG_UNIFORMTYPE_FLOAT4;
            desc.uniform_blocks[0].glsl_uniforms[0].array_count = 1;
            desc.uniform_blocks[0].glsl_uniforms[0].glsl_name = "effect_params";
            desc.uniform_blocks[1].stage = SG_SHADERSTAGE_VERTEX;
            desc.uniform_blocks[1].layout = SG_UNIFORMLAYOUT_STD140;
            desc.uniform_blocks[1].size = 16;
            desc.uniform_blocks[1].glsl_uniforms[0].type = SG_UNIFORMTYPE_FLOAT4;
            desc.uniform_blocks[1].glsl_uniforms[0].array_count = 1;
            desc.uniform_blocks[1].glsl_uniforms[0].glsl_name = "vs_params";
            desc.label = "rainbow_shader";
        }
        return &desc;
    }
    #endif /* SOKOL_GLES3 */
    #if defined(SOKOL_D3D11)
    if (backend == SG_BACKEND_D3D11) {
        static sg_shader_desc desc;
        static bool valid;
        if (!valid) {
            valid = true;
            desc.vertex_func.source = (const char*)vs_effect_source_hlsl5;
            desc.vertex_func.d3d11_target = "vs_5_0";
            desc.vertex_func.entry = "main";
            desc.fragment_func.source = (const char*)fs_rainbow_source_hlsl5;
            desc.fragment_func.d3d11_target = "ps_5_0";
            desc.fragment_func.entry = "main";
            desc.attrs[0].base_type = SG_SHADERATTRBASETYPE_FLOAT;
            desc.attrs[0].hlsl_sem_name = "TEXCOORD";
            desc.attrs[0].hlsl_sem_index = 0;
            desc.attrs[1].base_type = SG_SHADERATTRBASETYPE_FLOAT;
            desc.attrs[1].hlsl_sem_name = "TEXCOORD";
            desc.attrs[1].hlsl_sem_index = 1;
            desc.attrs[2].base_type = SG_SHADERATTRBASETYPE_FLOAT;
            desc.attrs[2].hlsl_sem_name = "TEXCOORD";
            desc.attrs[2].hlsl_sem_index = 2;
            desc.uniform_blocks[0].stage = SG_SHADERSTAGE_FRAGMENT;
            desc.uniform_blocks[0].layout = SG_UNIFORMLAYOUT_STD140;
            desc.uniform_blocks[0].size = 16;
            desc.uniform_blocks[0].hlsl_register_b_n = 0;
            desc.uniform_blocks[1].stage = SG_SHADERSTAGE_VERTEX;
            desc.uniform_blocks[1].layout = SG_UNIFORMLAYOUT_STD140;
            desc.uniform_blocks[1].size = 16;
            desc.uniform_blocks[1].hlsl_register_b_n = 1;
            desc.label = "rainbow_shader";
        }
        return &desc;
    }
    #endif /* SOKOL_D3D11 */
    #if defined(SOKOL_METAL)
    if (backend == SG_BACKEND_METAL_MACOS) {
        static sg_shader_desc desc;
        static bool valid;
        if (!valid) {
            valid = true;
            desc.vertex_func.source = (const char*)vs_effect_source_metal_macos;
            desc.vertex_func.entry = "main0";
            desc.fragment_func.source = (const char*)fs_rainbow_source_metal_macos;
            desc.fragment_func.entry = "main0";
            desc.attrs[0].base_type = SG_SHADERATTRBASETYPE_FLOAT;
            desc.attrs[1].base_type = SG_SHADERATTRBASETYPE_FLOAT;
            desc.attrs[2].base_type = SG_SHADERATTRBASETYPE_FLOAT;
            desc.uniform_blocks[0].stage = SG_SHADERSTAGE_FRAGMENT;
            desc.uniform_blocks[0].layout = SG_UNIFORMLAYOUT_STD140;
            desc.uniform_blocks[0].size = 16;
            desc.uniform_blocks[0].msl_buffer_n = 0;
            desc.uniform_blocks[1].stage = SG_SHADERSTAGE_VERTEX;
            desc.uniform_blocks[1].layout = SG_UNIFORMLAYOUT_STD140;
            desc.uniform_blocks[1].size = 16;
            desc.uniform_blocks[1].msl_buffer_n = 1;
            desc.label = "rainbow_shader";
        }
        return &desc;
    }
    #endif /* SOKOL_METAL */
    #if defined(SOKOL_WGPU)
    if (backend == SG_BACKEND_WGPU) {
        static sg_shader_desc desc;
        static bool valid;
        if (!valid) {
            valid = true;
            desc.vertex_func.source = (const char*)vs_effect_source_wgsl;
            desc.vertex_func.entry = "main";
            desc.fragment_func.source = (const char*)fs_rainbow_source_wgsl;
            desc.fragment_func.entry = "main";
            desc.attrs[0].base_type = SG_SHADERATTRBASETYPE_FLOAT;
            desc.attrs[1].base_type = SG_SHADERATTRBASETYPE_FLOAT;
            desc.attrs[2].base_type = SG_SHADERATTRBASETYPE_FLOAT;
            desc.uniform_blocks[0].stage = SG_SHADERSTAGE_FRAGMENT;
            desc.uniform_blocks[0].layout = SG_UNIFORMLAYOUT_STD140;
            desc.uniform_blocks[0].size = 16;
            desc.uniform_blocks[0].wgsl_group0_binding_n = 0;
            desc.uniform_blocks[1].stage = SG_SHADERSTAGE_VERTEX;
            desc.uniform_blocks[1].layout = SG_UNIFORMLAYOUT_STD140;
            desc.uniform_blocks[1].size = 16;
            desc.uniform_blocks[1].wgsl_group0_binding_n = 1;
            desc.label = "rainbow_shader";
        }
        return &desc;
    }
    #endif /* SOKOL_WGPU */
    return 0;
}
