#pragma once
/*
    #version:1# (machine generated, don't edit!)

    Generated by sokol-shdc (https://github.com/floooh/sokol-tools)

    Cmdline:
        sokol-shdc -i /Users/toru/Nextcloud/Make/TrussC/worktree/gpu-pbr/trussc/shaders/shadowDepth.glsl -o /Users/toru/Nextcloud/Make/TrussC/worktree/gpu-pbr/trussc/include/tc/gpu/shaders/shadowDepth.glsl.h -l metal_macos:metal_ios:hlsl5:glsl300es:wgsl --ifdef

    Overview:
    =========
    Shader program: 'shadow_depth':
        Get shader desc: shadow_depth_shader_desc(sg_query_backend());
        Vertex Shader: vs_shadow
        Fragment Shader: fs_shadow
        Attributes:
            ATTR_shadow_depth_position => 0
    Bindings:
        Uniform block 'shadow_vs_params':
            C struct: shadow_vs_params_t
            Bind slot: UB_shadow_vs_params => 0
*/
#if !defined(SOKOL_GFX_INCLUDED)
#error "Please include sokol_gfx.h before shadowDepth.glsl.h"
#endif
#if !defined(SOKOL_SHDC_ALIGN)
#if defined(_MSC_VER)
#define SOKOL_SHDC_ALIGN(a) __declspec(align(a))
#else
#define SOKOL_SHDC_ALIGN(a) __attribute__((aligned(a)))
#endif
#endif
#define ATTR_shadow_depth_position (0)
#define UB_shadow_vs_params (0)
#pragma pack(push,1)
SOKOL_SHDC_ALIGN(16) typedef struct shadow_vs_params_t {
    float model[16];
    float lightViewProj[16];
} shadow_vs_params_t;
#pragma pack(pop)
/*
    #version 300 es

    uniform vec4 shadow_vs_params[8];
    layout(location = 0) in vec3 position;
    out float v_linearDepth;

    void main()
    {
        vec4 _32 = (mat4(shadow_vs_params[4], shadow_vs_params[5], shadow_vs_params[6], shadow_vs_params[7]) * mat4(shadow_vs_params[0], shadow_vs_params[1], shadow_vs_params[2], shadow_vs_params[3])) * vec4(position, 1.0);
        gl_Position = _32;
        v_linearDepth = _32.w;
    }

*/
#if defined(SOKOL_GLES3)
static const uint8_t vs_shadow_source_glsl300es[404] = {
    0x23,0x76,0x65,0x72,0x73,0x69,0x6f,0x6e,0x20,0x33,0x30,0x30,0x20,0x65,0x73,0x0a,
    0x0a,0x75,0x6e,0x69,0x66,0x6f,0x72,0x6d,0x20,0x76,0x65,0x63,0x34,0x20,0x73,0x68,
    0x61,0x64,0x6f,0x77,0x5f,0x76,0x73,0x5f,0x70,0x61,0x72,0x61,0x6d,0x73,0x5b,0x38,
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    0x7d,0x0a,0x0a,0x00,
};
#endif
/*
    #version 300 es
    precision mediump float;
    precision highp int;

    layout(location = 0) out highp vec4 frag_color;
    in highp float v_linearDepth;

    void main()
    {
        frag_color = vec4(v_linearDepth, 0.0, 0.0, 1.0);
    }

*/
#if defined(SOKOL_GLES3)
static const uint8_t fs_shadow_source_glsl300es[213] = {
    0x23,0x76,0x65,0x72,0x73,0x69,0x6f,0x6e,0x20,0x33,0x30,0x30,0x20,0x65,0x73,0x0a,
    0x70,0x72,0x65,0x63,0x69,0x73,0x69,0x6f,0x6e,0x20,0x6d,0x65,0x64,0x69,0x75,0x6d,
    0x70,0x20,0x66,0x6c,0x6f,0x61,0x74,0x3b,0x0a,0x70,0x72,0x65,0x63,0x69,0x73,0x69,
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    0x0a,0x7d,0x0a,0x0a,0x00,
};
#endif
/*
    cbuffer shadow_vs_params : register(b0)
    {
        row_major float4x4 _13_model : packoffset(c0);
        row_major float4x4 _13_lightViewProj : packoffset(c4);
    };


    static float4 gl_Position;
    static float3 position;
    static float v_linearDepth;

    struct SPIRV_Cross_Input
    {
        float3 position : TEXCOORD0;
    };

    struct SPIRV_Cross_Output
    {
        float v_linearDepth : TEXCOORD0;
        float4 gl_Position : SV_Position;
    };

    void vert_main()
    {
        float4 _32 = mul(float4(position, 1.0f), mul(_13_model, _13_lightViewProj));
        gl_Position = _32;
        v_linearDepth = _32.w;
    }

    SPIRV_Cross_Output main(SPIRV_Cross_Input stage_input)
    {
        position = stage_input.position;
        vert_main();
        SPIRV_Cross_Output stage_output;
        stage_output.gl_Position = gl_Position;
        stage_output.v_linearDepth = v_linearDepth;
        return stage_output;
    }
*/
#if defined(SOKOL_D3D11)
static const uint8_t vs_shadow_source_hlsl5[829] = {
    0x63,0x62,0x75,0x66,0x66,0x65,0x72,0x20,0x73,0x68,0x61,0x64,0x6f,0x77,0x5f,0x76,
    0x73,0x5f,0x70,0x61,0x72,0x61,0x6d,0x73,0x20,0x3a,0x20,0x72,0x65,0x67,0x69,0x73,
    0x74,0x65,0x72,0x28,0x62,0x30,0x29,0x0a,0x7b,0x0a,0x20,0x20,0x20,0x20,0x72,0x6f,
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    0x65,0x5f,0x6f,0x75,0x74,0x70,0x75,0x74,0x3b,0x0a,0x7d,0x0a,0x00,
};
#endif
/*
    static float4 frag_color;
    static float v_linearDepth;

    struct SPIRV_Cross_Input
    {
        float v_linearDepth : TEXCOORD0;
    };

    struct SPIRV_Cross_Output
    {
        float4 frag_color : SV_Target0;
    };

    void frag_main()
    {
        frag_color = float4(v_linearDepth, 0.0f, 0.0f, 1.0f);
    }

    SPIRV_Cross_Output main(SPIRV_Cross_Input stage_input)
    {
        v_linearDepth = stage_input.v_linearDepth;
        frag_main();
        SPIRV_Cross_Output stage_output;
        stage_output.frag_color = frag_color;
        return stage_output;
    }
*/
#if defined(SOKOL_D3D11)
static const uint8_t fs_shadow_source_hlsl5[499] = {
    0x73,0x74,0x61,0x74,0x69,0x63,0x20,0x66,0x6c,0x6f,0x61,0x74,0x34,0x20,0x66,0x72,
    0x61,0x67,0x5f,0x63,0x6f,0x6c,0x6f,0x72,0x3b,0x0a,0x73,0x74,0x61,0x74,0x69,0x63,
    0x20,0x66,0x6c,0x6f,0x61,0x74,0x20,0x76,0x5f,0x6c,0x69,0x6e,0x65,0x61,0x72,0x44,
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    0x7d,0x0a,0x00,
};
#endif
/*
    #include <metal_stdlib>
    #include <simd/simd.h>

    using namespace metal;

    struct shadow_vs_params
    {
        float4x4 model;
        float4x4 lightViewProj;
    };

    struct main0_out
    {
        float v_linearDepth [[user(locn0)]];
        float4 gl_Position [[position]];
    };

    struct main0_in
    {
        float3 position [[attribute(0)]];
    };

    vertex main0_out main0(main0_in in [[stage_in]], constant shadow_vs_params& _13 [[buffer(0)]])
    {
        main0_out out = {};
        float4 _32 = (_13.lightViewProj * _13.model) * float4(in.position, 1.0);
        out.gl_Position = _32;
        out.v_linearDepth = _32.w;
        return out;
    }

*/
#if defined(SOKOL_METAL)
static const uint8_t vs_shadow_source_metal_macos[587] = {
    0x23,0x69,0x6e,0x63,0x6c,0x75,0x64,0x65,0x20,0x3c,0x6d,0x65,0x74,0x61,0x6c,0x5f,
    0x73,0x74,0x64,0x6c,0x69,0x62,0x3e,0x0a,0x23,0x69,0x6e,0x63,0x6c,0x75,0x64,0x65,
    0x20,0x3c,0x73,0x69,0x6d,0x64,0x2f,0x73,0x69,0x6d,0x64,0x2e,0x68,0x3e,0x0a,0x0a,
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    0x6e,0x20,0x6f,0x75,0x74,0x3b,0x0a,0x7d,0x0a,0x0a,0x00,
};
#endif
/*
    #include <metal_stdlib>
    #include <simd/simd.h>

    using namespace metal;

    struct main0_out
    {
        float4 frag_color [[color(0)]];
    };

    struct main0_in
    {
        float v_linearDepth [[user(locn0)]];
    };

    fragment main0_out main0(main0_in in [[stage_in]])
    {
        main0_out out = {};
        out.frag_color = float4(in.v_linearDepth, 0.0, 0.0, 1.0);
        return out;
    }

*/
#if defined(SOKOL_METAL)
static const uint8_t fs_shadow_source_metal_macos[353] = {
    0x23,0x69,0x6e,0x63,0x6c,0x75,0x64,0x65,0x20,0x3c,0x6d,0x65,0x74,0x61,0x6c,0x5f,
    0x73,0x74,0x64,0x6c,0x69,0x62,0x3e,0x0a,0x23,0x69,0x6e,0x63,0x6c,0x75,0x64,0x65,
    0x20,0x3c,0x73,0x69,0x6d,0x64,0x2f,0x73,0x69,0x6d,0x64,0x2e,0x68,0x3e,0x0a,0x0a,
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    0x00,
};
#endif
/*
    #include <metal_stdlib>
    #include <simd/simd.h>

    using namespace metal;

    struct shadow_vs_params
    {
        float4x4 model;
        float4x4 lightViewProj;
    };

    struct main0_out
    {
        float v_linearDepth [[user(locn0)]];
        float4 gl_Position [[position]];
    };

    struct main0_in
    {
        float3 position [[attribute(0)]];
    };

    vertex main0_out main0(main0_in in [[stage_in]], constant shadow_vs_params& _13 [[buffer(0)]])
    {
        main0_out out = {};
        float4 _32 = (_13.lightViewProj * _13.model) * float4(in.position, 1.0);
        out.gl_Position = _32;
        out.v_linearDepth = _32.w;
        return out;
    }

*/
#if defined(SOKOL_METAL)
static const uint8_t vs_shadow_source_metal_ios[587] = {
    0x23,0x69,0x6e,0x63,0x6c,0x75,0x64,0x65,0x20,0x3c,0x6d,0x65,0x74,0x61,0x6c,0x5f,
    0x73,0x74,0x64,0x6c,0x69,0x62,0x3e,0x0a,0x23,0x69,0x6e,0x63,0x6c,0x75,0x64,0x65,
    0x20,0x3c,0x73,0x69,0x6d,0x64,0x2f,0x73,0x69,0x6d,0x64,0x2e,0x68,0x3e,0x0a,0x0a,
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    0x6e,0x20,0x6f,0x75,0x74,0x3b,0x0a,0x7d,0x0a,0x0a,0x00,
};
#endif
/*
    #include <metal_stdlib>
    #include <simd/simd.h>

    using namespace metal;

    struct main0_out
    {
        float4 frag_color [[color(0)]];
    };

    struct main0_in
    {
        float v_linearDepth [[user(locn0)]];
    };

    fragment main0_out main0(main0_in in [[stage_in]])
    {
        main0_out out = {};
        out.frag_color = float4(in.v_linearDepth, 0.0, 0.0, 1.0);
        return out;
    }

*/
#if defined(SOKOL_METAL)
static const uint8_t fs_shadow_source_metal_ios[353] = {
    0x23,0x69,0x6e,0x63,0x6c,0x75,0x64,0x65,0x20,0x3c,0x6d,0x65,0x74,0x61,0x6c,0x5f,
    0x73,0x74,0x64,0x6c,0x69,0x62,0x3e,0x0a,0x23,0x69,0x6e,0x63,0x6c,0x75,0x64,0x65,
    0x20,0x3c,0x73,0x69,0x6d,0x64,0x2f,0x73,0x69,0x6d,0x64,0x2e,0x68,0x3e,0x0a,0x0a,
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    0x00,
};
#endif
/*
    diagnostic(off, derivative_uniformity);

    struct shadow_vs_params {
      /_ @offset(0) _/
      model : mat4x4f,
      /_ @offset(64) _/
      lightViewProj : mat4x4f,
    }

    @binding(0) @group(0) var<uniform> x_13 : shadow_vs_params;

    var<private> position_1 : vec3f;

    var<private> v_linearDepth : f32;

    var<private> gl_Position : vec4f;

    fn main_1() {
      var clipPos : vec4f;
      clipPos = ((x_13.lightViewProj * x_13.model) * vec4f(position_1.x, position_1.y, position_1.z, 1.0f));
      gl_Position = clipPos;
      v_linearDepth = clipPos.w;
      return;
    }

    struct main_out {
      @builtin(position)
      gl_Position : vec4f,
      @location(0)
      v_linearDepth_1 : f32,
    }

    @vertex
    fn main(@location(0) position_1_param : vec3f) -> main_out {
      position_1 = position_1_param;
      main_1();
      return main_out(gl_Position, v_linearDepth);
    }
*/
#if defined(SOKOL_WGPU)
static const uint8_t vs_shadow_source_wgsl[798] = {
    0x64,0x69,0x61,0x67,0x6e,0x6f,0x73,0x74,0x69,0x63,0x28,0x6f,0x66,0x66,0x2c,0x20,
    0x64,0x65,0x72,0x69,0x76,0x61,0x74,0x69,0x76,0x65,0x5f,0x75,0x6e,0x69,0x66,0x6f,
    0x72,0x6d,0x69,0x74,0x79,0x29,0x3b,0x0a,0x0a,0x73,0x74,0x72,0x75,0x63,0x74,0x20,
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    0x65,0x61,0x72,0x44,0x65,0x70,0x74,0x68,0x29,0x3b,0x0a,0x7d,0x0a,0x00,
};
#endif
/*
    diagnostic(off, derivative_uniformity);

    var<private> frag_color : vec4f;

    var<private> v_linearDepth : f32;

    fn main_1() {
      frag_color = vec4f(v_linearDepth, 0.0f, 0.0f, 1.0f);
      return;
    }

    struct main_out {
      @location(0)
      frag_color_1 : vec4f,
    }

    @fragment
    fn main(@location(0) v_linearDepth_param : f32) -> main_out {
      v_linearDepth = v_linearDepth_param;
      main_1();
      return main_out(frag_color);
    }
*/
#if defined(SOKOL_WGPU)
static const uint8_t fs_shadow_source_wgsl[409] = {
    0x64,0x69,0x61,0x67,0x6e,0x6f,0x73,0x74,0x69,0x63,0x28,0x6f,0x66,0x66,0x2c,0x20,
    0x64,0x65,0x72,0x69,0x76,0x61,0x74,0x69,0x76,0x65,0x5f,0x75,0x6e,0x69,0x66,0x6f,
    0x72,0x6d,0x69,0x74,0x79,0x29,0x3b,0x0a,0x0a,0x76,0x61,0x72,0x3c,0x70,0x72,0x69,
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    0x6c,0x6f,0x72,0x29,0x3b,0x0a,0x7d,0x0a,0x00,
};
#endif
static inline const sg_shader_desc* shadow_depth_shader_desc(sg_backend backend) {
    #if defined(SOKOL_GLES3)
    if (backend == SG_BACKEND_GLES3) {
        static sg_shader_desc desc;
        static bool valid;
        if (!valid) {
            valid = true;
            desc.vertex_func.source = (const char*)vs_shadow_source_glsl300es;
            desc.vertex_func.entry = "main";
            desc.fragment_func.source = (const char*)fs_shadow_source_glsl300es;
            desc.fragment_func.entry = "main";
            desc.attrs[0].base_type = SG_SHADERATTRBASETYPE_FLOAT;
            desc.attrs[0].glsl_name = "position";
            desc.uniform_blocks[0].stage = SG_SHADERSTAGE_VERTEX;
            desc.uniform_blocks[0].layout = SG_UNIFORMLAYOUT_STD140;
            desc.uniform_blocks[0].size = 128;
            desc.uniform_blocks[0].glsl_uniforms[0].type = SG_UNIFORMTYPE_FLOAT4;
            desc.uniform_blocks[0].glsl_uniforms[0].array_count = 8;
            desc.uniform_blocks[0].glsl_uniforms[0].glsl_name = "shadow_vs_params";
            desc.label = "shadow_depth_shader";
        }
        return &desc;
    }
    #endif /* SOKOL_GLES3 */
    #if defined(SOKOL_D3D11)
    if (backend == SG_BACKEND_D3D11) {
        static sg_shader_desc desc;
        static bool valid;
        if (!valid) {
            valid = true;
            desc.vertex_func.source = (const char*)vs_shadow_source_hlsl5;
            desc.vertex_func.d3d11_target = "vs_5_0";
            desc.vertex_func.entry = "main";
            desc.fragment_func.source = (const char*)fs_shadow_source_hlsl5;
            desc.fragment_func.d3d11_target = "ps_5_0";
            desc.fragment_func.entry = "main";
            desc.attrs[0].base_type = SG_SHADERATTRBASETYPE_FLOAT;
            desc.attrs[0].hlsl_sem_name = "TEXCOORD";
            desc.attrs[0].hlsl_sem_index = 0;
            desc.uniform_blocks[0].stage = SG_SHADERSTAGE_VERTEX;
            desc.uniform_blocks[0].layout = SG_UNIFORMLAYOUT_STD140;
            desc.uniform_blocks[0].size = 128;
            desc.uniform_blocks[0].hlsl_register_b_n = 0;
            desc.label = "shadow_depth_shader";
        }
        return &desc;
    }
    #endif /* SOKOL_D3D11 */
    #if defined(SOKOL_METAL)
    if (backend == SG_BACKEND_METAL_MACOS) {
        static sg_shader_desc desc;
        static bool valid;
        if (!valid) {
            valid = true;
            desc.vertex_func.source = (const char*)vs_shadow_source_metal_macos;
            desc.vertex_func.entry = "main0";
            desc.fragment_func.source = (const char*)fs_shadow_source_metal_macos;
            desc.fragment_func.entry = "main0";
            desc.attrs[0].base_type = SG_SHADERATTRBASETYPE_FLOAT;
            desc.uniform_blocks[0].stage = SG_SHADERSTAGE_VERTEX;
            desc.uniform_blocks[0].layout = SG_UNIFORMLAYOUT_STD140;
            desc.uniform_blocks[0].size = 128;
            desc.uniform_blocks[0].msl_buffer_n = 0;
            desc.label = "shadow_depth_shader";
        }
        return &desc;
    }
    #endif /* SOKOL_METAL */
    #if defined(SOKOL_METAL)
    if (backend == SG_BACKEND_METAL_IOS) {
        static sg_shader_desc desc;
        static bool valid;
        if (!valid) {
            valid = true;
            desc.vertex_func.source = (const char*)vs_shadow_source_metal_ios;
            desc.vertex_func.entry = "main0";
            desc.fragment_func.source = (const char*)fs_shadow_source_metal_ios;
            desc.fragment_func.entry = "main0";
            desc.attrs[0].base_type = SG_SHADERATTRBASETYPE_FLOAT;
            desc.uniform_blocks[0].stage = SG_SHADERSTAGE_VERTEX;
            desc.uniform_blocks[0].layout = SG_UNIFORMLAYOUT_STD140;
            desc.uniform_blocks[0].size = 128;
            desc.uniform_blocks[0].msl_buffer_n = 0;
            desc.label = "shadow_depth_shader";
        }
        return &desc;
    }
    #endif /* SOKOL_METAL */
    #if defined(SOKOL_WGPU)
    if (backend == SG_BACKEND_WGPU) {
        static sg_shader_desc desc;
        static bool valid;
        if (!valid) {
            valid = true;
            desc.vertex_func.source = (const char*)vs_shadow_source_wgsl;
            desc.vertex_func.entry = "main";
            desc.fragment_func.source = (const char*)fs_shadow_source_wgsl;
            desc.fragment_func.entry = "main";
            desc.attrs[0].base_type = SG_SHADERATTRBASETYPE_FLOAT;
            desc.uniform_blocks[0].stage = SG_SHADERSTAGE_VERTEX;
            desc.uniform_blocks[0].layout = SG_UNIFORMLAYOUT_STD140;
            desc.uniform_blocks[0].size = 128;
            desc.uniform_blocks[0].wgsl_group0_binding_n = 0;
            desc.label = "shadow_depth_shader";
        }
        return &desc;
    }
    #endif /* SOKOL_WGPU */
    return 0;
}
